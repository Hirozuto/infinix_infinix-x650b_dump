/dts-v1/;

/ {
	#address-cells = <0x2>;
	#size-cells = <0x2>;
	compatible = "mediatek,MT6761";
	interrupt-parent = <0x1>;
	model = "MT6761";

	__symbols__ {
		DPIDLE = "/cpus/idle-states/dpidle";
		MCDI_CLUSTER = "/cpus/idle-states/mcdi-cluster";
		MCDI_CPU = "/cpus/idle-states/mcdi-cpu";
		SODI = "/cpus/idle-states/sodi";
		SODI3 = "/cpus/idle-states/sodi3";
		STANDBY = "/cpus/idle-states/standby";
		SUSPEND = "/cpus/idle-states/suspend";
		accdet = "/accdet";
		apdma = "/dma-controller@11000580";
		apmixed = "/apmixed@1000c000";
		audgpio = "/mt_soc_dl1_pcm@11220000";
		audio = "/audio@11220000";
		auxadc = "/auxadc@11001000";
		bat_gm30 = "/battery";
		camsys = "/camsys@15000000";
		charger = "/charger";
		chosen = "/chosen";
		clk26m = "/clocks/clk26m";
		clk32k = "/clocks/clk32k";
		consys = "/consys@18002000";
		cpu0 = "/cpus/cpu@000";
		cpu1 = "/cpus/cpu@001";
		cpu2 = "/cpus/cpu@002";
		cpu3 = "/cpus/cpu@003";
		cpu_dbgapb = "/cpu_dbgapb@0d410000";
		disp_color0 = "/disp_color0@1400f000";
		disp_mutex0 = "/disp_mutex0@14001000";
		dsi_te = "/dsi_te";
		dynamic_options = "/dynamic_options";
		flashlight_core = "/flashlight_core";
		flashlights_aw3644 = "/flashlights_aw3644";
		flashlights_mt6370 = "/flashlights_mt6370";
		gce = "/gce@10238000";
		gce_mbox = "/gce_mbox@10238000";
		gic = "/interrupt-controller@0c000000";
		gpio = "/gpio@10005000";
		gpio_usage_mapping = "/gpio";
		i2c0 = "/i2c0@11007000";
		i2c1 = "/i2c1@11008000";
		i2c2 = "/i2c2@11009000";
		i2c3 = "/i2c3@1100f000";
		i2c4 = "/i2c4@11011000";
		i2c5 = "/i2c5@11016000";
		i2c6 = "/i2c6@1100d000";
		i2c7 = "/i2c7";
		i2c8 = "/i2c8";
		i2c9 = "/i2c9";
		i2c_common = "/i2c_common";
		infracfg_ao = "/infracfg_ao@10001000";
		iommu = "/m4u@10205000";
		irq_nfc = "/irq_nfc";
		kd_camera_hw1 = "/kd_camera_hw1@15040000";
		keypad = "/kp@10010000";
		lk_charger = "/lk_charger";
		main_pmic = "/mt-pmic";
		md1_sim1_hot_plug_eint = "/md1_sim1_hot_plug_eint";
		md1_sim2_hot_plug_eint = "/md1_sim2_hot_plug_eint";
		mdcldma = "/mdcldma@10014000";
		mdp_ccorr = "/mdp_ccorr0@14005000";
		mdp_rdma0 = "/mdp_rdma0@14004000";
		mdp_rsz0 = "/mdp_rsz0@14006000";
		mdp_rsz1 = "/mdp_rsz1@14007000";
		mdp_tdshp0 = "/mdp_tdshp0@1400a000";
		mdp_wdma0 = "/mdp_wdma0@14008000";
		mdp_wrot0 = "/mdp_wrot0@14009000";
		mfg_cfg = "/mfg_cfg@13ffe000";
		mipi_rx_ana_csi0a = "/mipi_rx_ana_csi0a@11c10000";
		mipi_rx_ana_csi0b = "/mipi_rx_ana_csi0b@11c11000";
		mipi_rx_ana_csi1a = "/mipi_rx_ana_csi1a@11c12000";
		mipi_rx_ana_csi1b = "/mipi_rx_ana_csi1b@11c13000";
		mipi_rx_ana_csi2a = "/mipi_rx_ana_csi2a@11c14000";
		mipi_rx_ana_csi2b = "/mipi_rx_ana_csi2b@11c15000";
		mm_mutex = "/mm_mutex@14016000";
		mmsys_config = "/mmsys_config@14000000";
		mrdump_ext_rst = "/mrdump_ext_rst";
		msdc0 = "/msdc@11230000";
		msdc0_pins_default = "/pinctrl@1000b000/msdc0@default";
		msdc0_pins_hs200 = "/pinctrl@1000b000/msdc0@hs200";
		msdc0_pins_hs400 = "/pinctrl@1000b000/msdc0@hs400";
		msdc0_register_setting_default = "/pinctrl@1000b000/msdc0@register_default";
		msdc1 = "/msdc@11240000";
		msdc1_ins = "/msdc1_ins@0";
		msdc1_pins_ddr50 = "/pinctrl@1000b000/msdc1@ddr50";
		msdc1_pins_default = "/pinctrl@1000b000/msdc1@default";
		msdc1_pins_sdr104 = "/pinctrl@1000b000/msdc1@sdr104";
		msdc1_pins_sdr50 = "/pinctrl@1000b000/msdc1@sdr50";
		msdc1_register_setting_default = "/pinctrl@1000b000/msdc1@register_default";
		msdc2 = "/msdc@11250000";
		msdc3 = "/msdc@11260000";
		msdc3_pins_default = "/pinctrl@1000b000/msdc3@default";
		msdc3_register_setting_default = "/pinctrl@1000b000/msdc3@register_default";
		mt6370_pmu = "/mt6370_pmu_dts";
		mt6370_typec = "/type_c_port0";
		mt_charger = "/mt_charger";
		mt_pmic_vaud28_ldo_reg = "/mt-pmic/ldo_regulators/ldo_vaud28";
		mt_pmic_vaux18_ldo_reg = "/mt-pmic/ldo_regulators/ldo_vaux18";
		mt_pmic_vcama_ldo_reg = "/mt-pmic/ldo_regulators/ldo_vcama";
		mt_pmic_vcamd_ldo_reg = "/mt-pmic/ldo_regulators/ldo_vcamd";
		mt_pmic_vcamio_ldo_reg = "/mt-pmic/ldo_regulators/ldo_vcamio";
		mt_pmic_vcn18_ldo_reg = "/mt-pmic/ldo_regulators/ldo_vcn18";
		mt_pmic_vcn28_ldo_reg = "/mt-pmic/ldo_regulators/ldo_vcn28";
		mt_pmic_vcn33_bt_ldo_reg = "/mt-pmic/ldo_regulators/ldo_vcn33_bt";
		mt_pmic_vcn33_wifi_ldo_reg = "/mt-pmic/ldo_regulators/ldo_vcn33_wifi";
		mt_pmic_vcore_buck_reg = "/mt-pmic/buck_regulators/buck_vcore";
		mt_pmic_vdram_ldo_reg = "/mt-pmic/ldo_regulators/ldo_vdram";
		mt_pmic_vefuse_ldo_reg = "/mt-pmic/ldo_regulators/ldo_vefuse";
		mt_pmic_vemc_ldo_reg = "/mt-pmic/ldo_regulators/ldo_vemc";
		mt_pmic_vfe28_ldo_reg = "/mt-pmic/ldo_regulators/ldo_vfe28";
		mt_pmic_vibr_ldo_reg = "/mt-pmic/ldo_regulators/ldo_vibr";
		mt_pmic_vio18_ldo_reg = "/mt-pmic/ldo_regulators/ldo_vio18";
		mt_pmic_vio28_ldo_reg = "/mt-pmic/ldo_regulators/ldo_vio28";
		mt_pmic_vldo28_ldo_reg = "/mt-pmic/ldo_regulators/ldo_vldo28";
		mt_pmic_vmc_ldo_reg = "/mt-pmic/ldo_regulators/ldo_vmc";
		mt_pmic_vmch_ldo_reg = "/mt-pmic/ldo_regulators/ldo_vmch";
		mt_pmic_vmodem_buck_reg = "/mt-pmic/buck_regulators/buck_vmodem";
		mt_pmic_vpa_buck_reg = "/mt-pmic/buck_regulators/buck_vpa";
		mt_pmic_vproc_buck_reg = "/mt-pmic/buck_regulators/buck_vproc";
		mt_pmic_vrf12_ldo_reg = "/mt-pmic/ldo_regulators/ldo_vrf12";
		mt_pmic_vrf18_ldo_reg = "/mt-pmic/ldo_regulators/ldo_vrf18";
		mt_pmic_vs1_buck_reg = "/mt-pmic/buck_regulators/buck_vs1";
		mt_pmic_vsim1_ldo_reg = "/mt-pmic/ldo_regulators/ldo_vsim1";
		mt_pmic_vsim2_ldo_reg = "/mt-pmic/ldo_regulators/ldo_vsim2";
		mt_pmic_vsram_others_ldo_reg = "/mt-pmic/ldo_regulators/ldo_vsram_others";
		mt_pmic_vsram_proc_ldo_reg = "/mt-pmic/ldo_regulators/ldo_vsram_proc";
		mt_pmic_vusb33_ldo_reg = "/mt-pmic/ldo_regulators/ldo_vusb33";
		mt_pmic_vxo22_ldo_reg = "/mt-pmic/ldo_regulators/ldo_vxo22";
		mtkfb = "/mtkfb@0";
		nfc = "/nfc";
		odm = "/odm";
		otg_iddig = "/otg_iddig";
		pericfg = "/pericfg@10003000";
		pio = "/pinctrl@1000b000";
		pmic_auxadc = "/mt-pmic/mt635x-auxadc";
		pmic_clock_buffer_ctrl = "/pmic_clock_buffer_ctrl";
		pwm = "/pwm@11006000";
		radio_md_cfg = "/radio_md_cfg";
		rt9465_slave_chr = "/rt9465_slave_chr";
		scpsys = "/scpsys@10001000";
		smart_pa = "/smart_pa";
		smi_larb0 = "/smi_larb0@14003000";
		smi_larb1 = "/smi_larb1@17010000";
		smi_larb2 = "/smi_larb2@15001000";
		spi0 = "/spi0@1100a000";
		spi1 = "/spi1@11010000";
		spi2 = "/spi2@11012000";
		spi3 = "/spi3@11013000";
		spi4 = "/spi4@11014000";
		spi5 = "/spi5@11015000";
		subpmic_pmu_eint = "/mt6370_pmu_eint";
		syscfg_pctl_0 = "/syscfg_pctl_0@10005000";
		syscfg_pctl_1 = "/syscfg_pctl_1@10002000";
		syscfg_pctl_2 = "/syscfg_pctl_2@10002200";
		syscfg_pctl_3 = "/syscfg_pctl_3@10002400";
		syscfg_pctl_4 = "/syscfg_pctl_4@10002600";
		syscfg_pctl_5 = "/syscfg_pctl_5@10002800";
		syscfg_pctl_6 = "/syscfg_pctl_6@10002a00";
		syscfg_pctl_7 = "/syscfg_pctl_7@10002c00";
		sysirq = "/intpol-controller@10200a80";
		tcpc_pd = "/tcpc_pd";
		timer = "/timer@10008000";
		topckgen = "/topckgen@10000000";
		touch = "/touch";
		uart0 = "/serial@11020000";
		uart1 = "/serial@11030000";
		venc_gcon = "/venc_gcon@17000000";
	};

	accdet {
		compatible = "mediatek,pmic-accdet";
		linux,phandle = <0x72>;
		phandle = <0x72>;
	};

	aes_top0@10016000 {
		compatible = "mediatek,aes_top0";
		reg = <0x0 0x10016000 0x0 0x1000>;
	};

	amms_control {
		compatible = "mediatek,amms";
		interrupts = <0x0 0x43 0x1>;
	};

	ap_ccif0@10209000 {
		compatible = "mediatek,ap_ccif0";
		interrupts = <0x0 0x5c 0x8>;
		reg = <0x0 0x10209000 0x0 0x1000>;
	};

	ap_ccif1@1020b000 {
		compatible = "mediatek,ap_ccif1";
		interrupts = <0x0 0x5e 0x8>;
		reg = <0x0 0x1020b000 0x0 0x1000>;
	};

	ap_ccif2@1023c000 {
		compatible = "mediatek,ap_ccif2";
		interrupts = <0x0 0x57 0x8>;
		reg = <0x0 0x1023c000 0x0 0x1000>;
	};

	ap_ccif3@1023e000 {
		compatible = "mediatek,ap_ccif3";
		interrupts = <0x0 0x5a 0x8>;
		reg = <0x0 0x1023e000 0x0 0x1000>;
	};

	ap_dma@11000000 {
		compatible = "mediatek,ap_dma";
		interrupts = <0x0 0x29 0x8>;
		reg = <0x0 0x11000000 0x0 0x1000>;
	};

	apcldmain@1021b000 {
		compatible = "mediatek,apcldmain";
		reg = <0x0 0x1021b000 0x0 0x100>;
	};

	apcldmain_ao@10014000 {
		compatible = "mediatek,apcldmain_ao";
		reg = <0x0 0x10014000 0x0 0x400>;
	};

	apcldmamisc@1021b800 {
		compatible = "mediatek,apcldmamisc";
		interrupts = <0x0 0x6d 0x4>;
		reg = <0x0 0x1021b800 0x0 0x100>;
	};

	apcldmamisc_ao@10014800 {
		compatible = "mediatek,apcldmamisc_ao";
		reg = <0x0 0x10014800 0x0 0x400>;
	};

	apcldmamisc_ao@10014c00 {
		compatible = "mediatek,apcldmamisc_ao";
		reg = <0x0 0x10014c00 0x0 0x400>;
	};

	apcldmaout@1021b400 {
		compatible = "mediatek,apcldmaout";
		reg = <0x0 0x1021b400 0x0 0x100>;
	};

	apcldmaout_ao@10014400 {
		compatible = "mediatek,apcldmaout_ao";
		reg = <0x0 0x10014400 0x0 0x400>;
	};

	apirq@1000b000 {
		compatible = "mediatek,apirq";
		interrupts = <0x0 0x73 0x4>;
		reg = <0x0 0x1000b000 0x0 0x1000>;
	};

	apmixed@1000c000 {
		#clock-cells = <0x1>;
		compatible = "mediatek,apmixed", "syscon";
		linux,phandle = <0x3b>;
		phandle = <0x3b>;
		reg = <0x0 0x1000c000 0x0 0x1000>;
	};

	atf_logger {
		compatible = "mediatek,atf_logger";
		interrupts = <0x0 0x4e 0x1>;
	};

	audio@11220000 {
		#clock-cells = <0x1>;
		compatible = "mediatek,audio", "syscon";
		linux,phandle = <0x3a>;
		phandle = <0x3a>;
		reg = <0x0 0x11220000 0x0 0x1000>;
	};

	audio_snd_card {
		compatible = "mediatek,audio_snd_card";
	};

	audio_sram@11221000 {
		compatible = "mediatek,audio_sram";
		reg = <0x0 0x11221000 0x0 0x9000>;
	};

	auxadc@11001000 {
		clock-names = "auxadc-main";
		clocks = <0x1f 0x21>;
		compatible = "mediatek,auxadc";
		interrupts = <0x0 0x14 0x2>;
		linux,phandle = <0x75>;
		phandle = <0x75>;
		reg = <0x0 0x11001000 0x0 0x1000>;
	};

	battery {
		CAR_TUNE_VALUE = <0x64>;
		DIFFERENCE_FULLOCV_ITH = <0xc8>;
		EMBEDDED_SEL = <0x1>;
		FG_METER_RESISTANCE = <0x4b>;
		KEEP_100_PERCENT = <0x1>;
		PMIC_MIN_VOL = <0x82dc>;
		PMIC_SHUTDOWN_CURRENT = <0x14>;
		POWERON_SYSTEM_IBOOT = <0x1f4>;
		Q_MAX_SYS_VOLTAGE_BAT0 = <0xd16>;
		Q_MAX_SYS_VOLTAGE_BAT1 = <0xd16>;
		Q_MAX_SYS_VOLTAGE_BAT2 = <0xd16>;
		Q_MAX_SYS_VOLTAGE_BAT3 = <0xd16>;
		R_FG_VALUE = <0xa>;
		SHUTDOWN_1_TIME = <0x1e>;
		SHUTDOWN_GAUGE0_VOLTAGE = <0x84d0>;
		TEMPERATURE_T0 = <0x32>;
		TEMPERATURE_T1 = <0x19>;
		TEMPERATURE_T2 = <0xa>;
		TEMPERATURE_T3 = <0x0>;
		TEMPERATURE_T4 = <0xfffffff6>;
		battery0_profile_t0 = <0x0 0xaaaa 0x44c 0x1f9 0xa9f4 0x44c 0x3f2 0xa95d 0x469 0x5eb 0xa8c6 0x44c 0x7e4 0xa843 0x44c 0x9dd 0xa7c0 0x44e 0xbd6 0xa746 0x468 0xdcf 0xa6c4 0x44c 0xfc8 0xa64a 0x44e 0x11c1 0xa5d0 0x467 0x13bb 0xa54f 0x44f 0x15b4 0xa4df 0x46a 0x17ad 0xa465 0x466 0x19a6 0xa3ec 0x44c 0x1b9f 0xa374 0x450 0x1d98 0xa304 0x46a 0x1f91 0xa28c 0x46a 0x218a 0xa21b 0x465 0x2383 0xa1a4 0x44c 0x257c 0xa135 0x450 0x2775 0xa0c6 0x45c 0x296e 0xa059 0x457 0x2b67 0x9ff2 0x47a 0x2d60 0x9f85 0x46f 0x2f59 0x9f1d 0x479 0x3152 0x9eb1 0x467 0x334b 0x9e4c 0x463 0x3544 0x9de9 0x46f 0x373d 0x9d8c 0x47e 0x3936 0x9d2a 0x487 0x3b30 0x9cd2 0x49c 0x3d29 0x9c74 0x49c 0x3f22 0x9c19 0x49c 0x411b 0x9bc1 0x4a3 0x4314 0x9b6d 0x4b0 0x450d 0x9b16 0x4b0 0x4706 0x9ac5 0x4bb 0x48ff 0x9a74 0x4ce 0x4af8 0x9a27 0x4d6 0x4cf1 0x99dc 0x4ee 0x4eea 0x998c 0x500 0x50e3 0x993b 0x508 0x52dc 0x98dd 0x50c 0x54d5 0x9866 0x4ea 0x56ce 0x97e2 0x4aa 0x58c7 0x9771 0x47e 0x5ac0 0x971b 0x475 0x5cb9 0x96cf 0x45c 0x5eb2 0x968d 0x44c 0x60ab 0x9655 0x45b 0x62a5 0x961e 0x45b 0x649e 0x95e6 0x44c 0x6697 0x95b9 0x45c 0x6890 0x958b 0x45a 0x6a89 0x955e 0x45c 0x6c82 0x9536 0x46a 0x6e7b 0x950d 0x46a 0x7074 0x94e5 0x46a 0x726d 0x94bd 0x46a 0x7466 0x949a 0x46a 0x765f 0x947c 0x476 0x7858 0x9457 0x47e 0x7a51 0x9435 0x47e 0x7c4a 0x941d 0x491 0x7e43 0x9403 0x49c 0x803c 0x93eb 0x4a9 0x8235 0x93d0 0x4b0 0x842e 0x93b8 0x4b0 0x8627 0x939d 0x4b0 0x8820 0x937f 0x4b0 0x8a1a 0x9353 0x4a2 0x8c13 0x930b 0x478 0x8e0c 0x92c8 0x46a 0x9005 0x9293 0x46a 0x91fe 0x9270 0x479 0x93f7 0x924a 0x47e 0x95f0 0x921a 0x46f 0x97e9 0x91ef 0x46a 0x99e2 0x91ce 0x47a 0x9bdb 0x91b0 0x47e 0x9dd4 0x918a 0x47e 0x9fcd 0x9161 0x497 0xa1c6 0x9128 0x49c 0xa3bf 0x90e3 0x483 0xa5b8 0x90a5 0x47e 0xa7b1 0x9071 0x498 0xa9aa 0x901c 0x482 0xaba3 0x8fd2 0x452 0xad9c 0x8fc1 0x467 0xaf95 0x8fb7 0x47c 0xb18f 0x8fad 0x499 0xb388 0x8f9a 0x4ae 0xb581 0x8f85 0x4fa 0xb77a 0x8f42 0x513 0xb973 0x8e3e 0x4d2 0xbb6c 0x8c77 0x4e1 0xbd65 0x8a1e 0x512 0xbf5e 0x86d5 0x562 0xc157 0x86c4 0x564 0xc350 0x86c4 0x564>;
		battery0_profile_t0_num = <0x64>;
		battery0_profile_t1 = <0x0 0xab54 0x65e 0x1f9 0xaa80 0x65e 0x3f2 0xa9d5 0x65e 0x5eb 0xa948 0x65d 0x7e4 0xa8bb 0x640 0x9dd 0xa837 0x640 0xbd6 0xa7b4 0x63f 0xdcf 0xa732 0x62c 0xfc8 0xa6b8 0x62c 0x11c1 0xa63f 0x62c 0x13bb 0xa5c6 0x62c 0x15b4 0xa54d 0x62c 0x17ad 0xa4d3 0x62c 0x19a6 0xa45a 0x628 0x1b9f 0xa3e1 0x60e 0x1d98 0xa369 0x60e 0x1f91 0xa2f9 0x60e 0x218a 0xa281 0x60e 0x2383 0xa212 0x60e 0x257c 0xa1a3 0x60e 0x2775 0xa134 0x614 0x296e 0xa0c5 0x626 0x2b67 0xa056 0x60e 0x2d60 0x9fe9 0x615 0x2f59 0x9f81 0x625 0x3152 0x9f17 0x61b 0x334b 0x9eba 0x640 0x3544 0x9e55 0x640 0x373d 0x9ded 0x640 0x3936 0x9d7e 0x640 0x3b30 0x9d0f 0x640 0x3d29 0x9ca6 0x646 0x3f22 0x9c4e 0x65e 0x411b 0x9bfd 0x672 0x4314 0x9bb0 0x67c 0x450d 0x9b66 0x690 0x4706 0x9b15 0x697 0x48ff 0x9ac4 0x6a4 0x4af8 0x9a73 0x6b0 0x4cf1 0x9a22 0x6ca 0x4eea 0x99d2 0x6d6 0x50e3 0x9981 0x6e2 0x52dc 0x9923 0x6df 0x54d5 0x98b4 0x6ac 0x56ce 0x9841 0x66c 0x58c7 0x97cc 0x629 0x5ac0 0x9762 0x5ed 0x5cb9 0x970b 0x5c8 0x5eb2 0x96c4 0x5b9 0x60ab 0x9682 0x5aa 0x62a5 0x9646 0x5aa 0x649e 0x960e 0x5aa 0x6697 0x95dc 0x5aa 0x6890 0x95af 0x5aa 0x6a89 0x9586 0x5ba 0x6c82 0x9558 0x5b7 0x6e7b 0x9531 0x5bb 0x7074 0x950d 0x5b7 0x726d 0x94e5 0x5aa 0x7466 0x94c2 0x5bc 0x765f 0x949e 0x5b6 0x7858 0x947c 0x5aa 0x7a51 0x945d 0x5bd 0x7c4a 0x9445 0x5d5 0x7e43 0x942b 0x5dc 0x803c 0x9413 0x5f0 0x8235 0x93f8 0x5e6 0x842e 0x93e0 0x5f0 0x8627 0x93cc 0x608 0x8820 0x93b1 0x600 0x8a1a 0x939a 0x5fa 0x8c13 0x937e 0x5e4 0x8e0c 0x9360 0x5dc 0x9005 0x9342 0x5cd 0x91fe 0x9324 0x5c8 0x93f7 0x92fe 0x5c8 0x95f0 0x92dd 0x5c8 0x97e9 0x92b7 0x5c8 0x99e2 0x928e 0x5c8 0x9bdb 0x926e 0x5d8 0x9dd4 0x9248 0x5dc 0x9fcd 0x921f 0x5dc 0xa1c6 0x91f7 0x605 0xa3bf 0x91b5 0x5fd 0xa5b8 0x9177 0x60b 0xa7b1 0x913a 0x628 0xa9aa 0x90fe 0x62c 0xaba3 0x90a7 0x62c 0xad9c 0x905e 0x63e 0xaf95 0x9044 0x65b 0xb18f 0x9030 0x670 0xb388 0x9025 0x6a0 0xb581 0x9011 0x6d2 0xb77a 0x8ff4 0x734 0xb973 0x8fb0 0x799 0xbb6c 0x8ecf 0x7bb 0xbd65 0x8cf5 0x7ec 0xbf5e 0x8a73 0x8b2 0xc157 0x86f5 0x9df 0xc350 0x86ec 0x9e2>;
		battery0_profile_t1_num = <0x64>;
		battery0_profile_t2 = <0x0 0xab0e 0xc3a 0x1f9 0xaa44 0xc3a 0x3f2 0xa9a3 0xc1c 0x5eb 0xa916 0xc07 0x7e4 0xa893 0xbe9 0x9dd 0xa80f 0xbd3 0xbd6 0xa78c 0xba1 0xdcf 0xa70a 0xb70 0xfc8 0xa690 0xb52 0x11c1 0xa617 0xb3b 0x13bb 0xa59e 0xb0b 0x15b4 0xa525 0xaee 0x17ad 0xa4ad 0xadc 0x19a6 0xa43c 0xad5 0x1b9f 0xa3c3 0xaa6 0x1d98 0xa34b 0xa8c 0x1f91 0xa2dc 0xa89 0x218a 0xa26d 0xa78 0x2383 0xa1fc 0xa73 0x257c 0xa185 0xa56 0x2775 0xa116 0xa46 0x296e 0xa0a7 0xa46 0x2b67 0xa03a 0xa46 0x2d60 0x9fd5 0xa4b 0x2f59 0x9f70 0xa5a 0x3152 0x9f10 0xa67 0x334b 0x9eba 0xa8c 0x3544 0x9e52 0xa8c 0x373d 0x9dda 0xa7e 0x3936 0x9d4d 0xa54 0x3b30 0x9cc6 0xa46 0x3d29 0x9c53 0xa46 0x3f22 0x9bf4 0xa4c 0x411b 0x9ba7 0xa64 0x4314 0x9b60 0xa7f 0x450d 0x9b19 0xa8c 0x4706 0x9acf 0xa8c 0x48ff 0x9a7e 0xa8c 0x4af8 0x9a29 0xa84 0x4cf1 0x99cf 0xa78 0x4eea 0x9970 0xa64 0x50e3 0x9906 0xa25 0x52dc 0x989c 0x9ee 0x54d5 0x9832 0x9bf 0x56ce 0x97c8 0x973 0x58c7 0x9767 0x935 0x5ac0 0x9715 0x91a 0x5cb9 0x96cf 0x91a 0x5eb2 0x9688 0x90b 0x60ab 0x964b 0x8fc 0x62a5 0x9614 0x8fc 0x649e 0x95dc 0x8fc 0x6697 0x95aa 0x8fc 0x6890 0x957d 0x90c 0x6a89 0x9554 0x91a 0x6c82 0x952c 0x925 0x6e7b 0x9503 0x92e 0x7074 0x94db 0x93f 0x726d 0x94b3 0x93a 0x7466 0x9490 0x940 0x765f 0x9472 0x958 0x7858 0x9454 0x960 0x7a51 0x9435 0x973 0x7c4a 0x9417 0x97e 0x7e43 0x93ff 0x98b 0x803c 0x93eb 0x992 0x8235 0x93d7 0x9a6 0x842e 0x93c2 0x9b0 0x8627 0x93ae 0x9be 0x8820 0x93a1 0x9d9 0x8a1a 0x9397 0xa05 0x8c13 0x9386 0xa14 0x8e0c 0x9371 0xa23 0x9005 0x935d 0xa3e 0x91fe 0x9349 0xa55 0x93f7 0x932d 0xa80 0x95f0 0x9307 0xaa3 0x97e9 0x92e7 0xad1 0x99e2 0x92c0 0xaec 0x9bdb 0x9298 0xb18 0x9dd4 0x9270 0xb63 0x9fcd 0x923f 0xbab 0xa1c6 0x9204 0xbe1 0xa3bf 0x91c8 0xc2d 0xa5b8 0x9183 0xc75 0xa7b1 0x9144 0xcf0 0xa9aa 0x90f7 0xd59 0xaba3 0x90a6 0xdbe 0xad9c 0x9067 0xe4f 0xaf95 0x903c 0xef9 0xb18f 0x9026 0x1009 0xb388 0x8fff 0x111a 0xb581 0x8fd7 0x12a4 0xb77a 0x8f9c 0x1467 0xb973 0x8f26 0x165d 0xbb6c 0x8e27 0x1886 0xbd65 0x8c41 0x1b43 0xbf5e 0x898e 0x2083 0xc157 0x85b6 0x2a03 0xc350 0x85ac 0x2a1c>;
		battery0_profile_t2_num = <0x64>;
		battery0_profile_t3 = <0x0 0xab2c 0x1838 0x1f9 0xaa3a 0x1836 0x3f2 0xa97b 0x178a 0x5eb 0xa8d9 0x16d8 0x7e4 0xa842 0x1698 0x9dd 0xa7b5 0x16f5 0xbd6 0xa732 0x16c0 0xdcf 0xa6af 0x1660 0xfc8 0xa62b 0x1640 0x11c1 0xa5a9 0x160d 0x13bb 0xa530 0x15db 0x15b4 0xa4b7 0x15a6 0x17ad 0xa43d 0x155e 0x19a6 0xa3c6 0x1511 0x1b9f 0xa356 0x14dc 0x1d98 0xa2e7 0x1476 0x1f91 0xa278 0x1378 0x218a 0xa209 0x1329 0x2383 0xa19a 0x1358 0x257c 0xa12b 0x13c0 0x2775 0xa0bc 0x13ce 0x296e 0xa04f 0x139b 0x2b67 0x9fec 0x1372 0x2d60 0x9f91 0x1371 0x2f59 0x9f36 0x138f 0x3152 0x9ed6 0x139e 0x334b 0x9e62 0x137b 0x3544 0x9ddf 0x133b 0x373d 0x9d5b 0x12c8 0x3936 0x9cdb 0x1227 0x3b30 0x9c65 0x11a2 0x3d29 0x9bf9 0x11b3 0x3f22 0x9b97 0x1212 0x411b 0x9b43 0x1259 0x4314 0x9af9 0x1270 0x450d 0x9aab 0x125c 0x4706 0x9a5d 0x1255 0x48ff 0x9a02 0x123d 0x4af8 0x99a7 0x1217 0x4cf1 0x994d 0x11e4 0x4eea 0x98ee 0x11aa 0x50e3 0x988d 0x115f 0x52dc 0x9832 0x10f0 0x54d5 0x97d7 0x107c 0x56ce 0x977c 0x1030 0x58c7 0x972a 0x1056 0x5ac0 0x96df 0x10c1 0x5cb9 0x9698 0x10cc 0x5eb2 0x9656 0x10c2 0x60ab 0x9619 0x10c2 0x62a5 0x95e2 0x10b3 0x649e 0x95aa 0x10a9 0x6697 0x957d 0x10d2 0x6890 0x954f 0x1105 0x6a89 0x9522 0x1127 0x6c82 0x94fa 0x1141 0x6e7b 0x94d1 0x113d 0x7074 0x94a9 0x1141 0x726d 0x9486 0x116b 0x7466 0x9468 0x119e 0x765f 0x944a 0x11be 0x7858 0x9432 0x11d8 0x7a51 0x941d 0x11f1 0x7c4a 0x9409 0x120b 0x7e43 0x93f5 0x1243 0x803c 0x93e7 0x12b1 0x8235 0x93d7 0x130d 0x842e 0x93c9 0x1368 0x8627 0x93bf 0x13bf 0x8820 0x93ae 0x141e 0x8a1a 0x939a 0x1483 0x8c13 0x938d 0x14f6 0x8e0c 0x937b 0x1577 0x9005 0x9360 0x15bf 0x91fe 0x9349 0x1626 0x93f7 0x932d 0x16cc 0x95f0 0x930f 0x177b 0x97e9 0x92e9 0x1817 0x99e2 0x92c8 0x18c6 0x9bdb 0x92a2 0x1974 0x9dd4 0x9272 0x1a0f 0x9fcd 0x923f 0x1ae8 0xa1c6 0x9204 0x1b9f 0xa3bf 0x91c8 0x1c7d 0xa5b8 0x918b 0x1d76 0xa7b1 0x9146 0x1e59 0xa9aa 0x9108 0x1f7d 0xaba3 0x90c2 0x20c6 0xad9c 0x9085 0x21f9 0xaf95 0x9051 0x241a 0xb18f 0x901f 0x2663 0xb388 0x8fec 0x28d2 0xb581 0x8fb0 0x2b7c 0xb77a 0x8f74 0x2e7f 0xb973 0x8f1b 0x3193 0xbb6c 0x8e7c 0x33dd 0xbd65 0x8d7a 0x35d9 0xbf5e 0x8baf 0x38c7 0xc157 0x88f1 0x3ea3 0xc350 0x84bc 0x47fe>;
		battery0_profile_t3_num = <0x64>;
		battery0_profile_t4 = <0x0 0xab22 0x3250 0x1f9 0xaa12 0x324f 0x3f2 0xa92a 0x31fd 0x5eb 0xa86a 0x314e 0x7e4 0xa7ac 0x3053 0x9dd 0xa70a 0x2f6b 0xbd6 0xa668 0x2e8c 0xdcf 0xa5c8 0x2da8 0xfc8 0xa53b 0x2cfb 0x11c1 0xa4ae 0x2c47 0x13bb 0xa42b 0x2b9d 0x15b4 0xa3a9 0x2b05 0x17ad 0xa32f 0x2a70 0x19a6 0xa2b6 0x29ea 0x1b9f 0xa23d 0x2957 0x1d98 0xa1c5 0x28dc 0x1f91 0xa156 0x285b 0x218a 0xa0e9 0x27e5 0x2383 0xa084 0x2780 0x257c 0xa021 0x271f 0x2775 0x9fc2 0x26ca 0x296e 0x9f53 0x2665 0x2b67 0x9ee1 0x25fb 0x2d60 0x9e63 0x2579 0x2f59 0x9dd6 0x24dc 0x3152 0x9d4b 0x2451 0x334b 0x9cca 0x23d6 0x3544 0x9c54 0x2379 0x373d 0x9be8 0x2338 0x3936 0x9b86 0x230b 0x3b30 0x9b2e 0x22f6 0x3d29 0x9ada 0x22f0 0x3f22 0x9a82 0x22e2 0x411b 0x9a2e 0x22d8 0x4314 0x99d3 0x22b3 0x450d 0x997c 0x2280 0x4706 0x9927 0x223c 0x48ff 0x98d0 0x21e9 0x4af8 0x987b 0x21b7 0x4cf1 0x9824 0x2184 0x4eea 0x97d8 0x2166 0x50e3 0x978d 0x2151 0x52dc 0x9740 0x2134 0x54d5 0x96fa 0x211e 0x56ce 0x96b7 0x20f9 0x58c7 0x967b 0x20ee 0x5ac0 0x963e 0x20ee 0x5cb9 0x9602 0x20e0 0x5eb2 0x95ca 0x20df 0x60ab 0x9597 0x20ee 0x62a5 0x956a 0x20f8 0x649e 0x953c 0x2111 0x6697 0x950f 0x212b 0x6890 0x94e7 0x2144 0x6a89 0x94c4 0x216d 0x6c82 0x94a5 0x21a0 0x6e7b 0x948d 0x21de 0x7074 0x9478 0x222a 0x726d 0x9464 0x2269 0x7466 0x9450 0x22ba 0x765f 0x943c 0x230c 0x7858 0x9428 0x2366 0x7a51 0x9413 0x23cb 0x7c4a 0x93ff 0x2430 0x7e43 0x93f2 0x24b5 0x803c 0x93e1 0x253f 0x8235 0x93cd 0x25d0 0x842e 0x93b8 0x2668 0x8627 0x93a4 0x26ff 0x8820 0x9390 0x27a4 0x8a1a 0x937c 0x2857 0x8c13 0x9368 0x2906 0x8e0c 0x934c 0x29b9 0x9005 0x9335 0x2a8c 0x91fe 0x931a 0x2b4d 0x93f7 0x92fb 0x2c21 0x95f0 0x92dd 0x2cf0 0x97e9 0x92b7 0x2dba 0x99e2 0x928e 0x2e9b 0x9bdb 0x9266 0x2f7c 0x9dd4 0x923e 0x3072 0x9fcd 0x920d 0x315e 0xa1c6 0x91db 0x3257 0xa3bf 0x91a0 0x3354 0xa5b8 0x916c 0x3461 0xa7b1 0x9128 0x354f 0xa9aa 0x90ea 0x365b 0xaba3 0x90ad 0x3786 0xad9c 0x9071 0x38b5 0xaf95 0x903d 0x39ff 0xb18f 0x9014 0x3b5e 0xb388 0x8feb 0x3cee 0xb581 0x8fc3 0x3eb0 0xb77a 0x8f88 0x40b8 0xb973 0x8f25 0x42ff 0xbb6c 0x8e6a 0x459f 0xbd65 0x8d05 0x48f2 0xbf5e 0x8acc 0x4e37 0xc157 0x877f 0x54d7 0xc350 0x866a 0x5226>;
		battery0_profile_t4_num = <0x64>;
		battery1_profile_t0 = <0x0 0xaa7f 0x3f2 0x1fa 0xa9e5 0x3f2 0x3f3 0xa959 0x3f2 0x5ed 0xa8d6 0x3f2 0x7e6 0xa855 0x3f2 0x9e0 0xa7db 0x3fc 0xbd9 0xa75a 0x3fd 0xdd3 0xa6e1 0x405 0xfcc 0xa667 0x3fc 0x11c6 0xa5ef 0x3fc 0x13bf 0xa575 0x3fc 0x15b9 0xa4fb 0x3fc 0x17b2 0xa487 0x3ff 0x19ac 0xa413 0x40f 0x1ba5 0xa39c 0x408 0x1d9f 0xa328 0x40e 0x1f98 0xa2b4 0x408 0x2192 0xa243 0x410 0x238b 0xa1d1 0x410 0x2585 0xa162 0x412 0x277f 0xa0f2 0x41a 0x2978 0xa085 0x41c 0x2b72 0xa01a 0x424 0x2d6b 0x9fae 0x421 0x2f65 0x9f46 0x41d 0x315e 0x9edf 0x424 0x3358 0x9e78 0x424 0x3551 0x9e14 0x42a 0x374b 0x9db3 0x438 0x3944 0x9d52 0x435 0x3b3e 0x9cf2 0x431 0x3d37 0x9c3c 0x43b 0x3f31 0x9be5 0x446 0x412a 0x9b8f 0x450 0x4324 0x9b3c 0x45a 0x451d 0x9ae9 0x464 0x4717 0x9a99 0x46e 0x4910 0x9a4b 0x47c 0x4b0a 0x99fc 0x490 0x4d03 0x99ad 0x4a5 0x4efd 0x9951 0x4b0 0x50f7 0x98dc 0x495 0x52f0 0x9851 0x454 0x54ea 0x97d2 0x424 0x56e3 0x9771 0x410 0x58dd 0x9722 0x40b 0x5ad6 0x96e0 0x40b 0x5cd0 0x96a3 0x406 0x5ec9 0x9668 0x401 0x60c3 0x962f 0x401 0x62bc 0x95fc 0x406 0x64b6 0x95ca 0x406 0x66af 0x959a 0x406 0x68a9 0x956c 0x40c 0x6aa2 0x9540 0x410 0x6c9c 0x9514 0x40a 0x6e95 0x94ec 0x40c 0x708f 0x94c5 0x410 0x7288 0x94a0 0x41d 0x7482 0x947c 0x41d 0x767c 0x945a 0x421 0x7875 0x9439 0x424 0x7a6f 0x941b 0x424 0x7c68 0x93ff 0x432 0x7e62 0x93e2 0x438 0x805b 0x93c8 0x446 0x8255 0x93b1 0x453 0x844e 0x9392 0x456 0x8648 0x936b 0x44e 0x8841 0x9326 0x41e 0x8a3b 0x92d5 0x401 0x8c34 0x9295 0x404 0x8e2e 0x9263 0x40e 0x9027 0x9239 0x410 0x9221 0x920b 0x410 0x941a 0x91e1 0x418 0x9614 0x91b8 0x412 0x980d 0x9198 0x410 0x9a07 0x9176 0x419 0x9c00 0x9153 0x423 0x9dfa 0x9125 0x424 0x9ff4 0x90eb 0x41b 0xa1ed 0x90ad 0x41a 0xa3e7 0x9075 0x423 0xa5e0 0x9036 0x424 0xa7da 0x8fe6 0x41b 0xa9d3 0x8fac 0x3fd 0xabcd 0x8f98 0x406 0xadc6 0x8f8d 0x410 0xafc0 0x8f81 0x437 0xb1b9 0x8f55 0x4a6 0xb3b3 0x8ef3 0x4a5 0xb5ac 0x8dbf 0x44c 0xb7a6 0x8bf7 0x461 0xb99f 0x899e 0x48a 0xbb99 0x865b 0x4c0 0xbd92 0x80e1 0x6f5 0xbf8c 0x74cd 0x2224 0xc185 0x74cd 0x2224 0xc37f 0x74cd 0x2224>;
		battery1_profile_t0_num = <0x64>;
		battery1_profile_t1 = <0x0 0xab3f 0x4e2 0x1fa 0xaaac 0x4e2 0x3f3 0xaa22 0x4ce 0x5ed 0xa9a2 0x4ce 0x7e6 0xa925 0x4ce 0x9e0 0xa8a7 0x4ce 0xbd9 0xa82a 0x4ce 0xdd3 0xa7b0 0x4ce 0xfcc 0xa736 0x4ce 0x11c6 0xa6bf 0x4ce 0x13bf 0xa645 0x4ce 0x15b9 0xa5cd 0x4ce 0x17b2 0xa553 0x4ce 0x19ac 0xa4dc 0x4ce 0x1ba5 0xa465 0x4cc 0x1d9f 0xa3ee 0x4c4 0x1f98 0xa37b 0x4c4 0x2192 0xa306 0x4c4 0x238b 0xa293 0x4c6 0x2585 0xa222 0x4d2 0x277f 0xa1b1 0x4e0 0x2978 0xa142 0x4da 0x2b72 0xa0d3 0x4e4 0x2d6b 0xa063 0x4ec 0x2f65 0x9ff6 0x4ef 0x315e 0x9f8d 0x4f9 0x3358 0x9f26 0x503 0x3551 0x9ec7 0x513 0x374b 0x9e69 0x528 0x3944 0x9e00 0x528 0x3b3e 0x9d8b 0x52b 0x3d37 0x9d15 0x532 0x3f31 0x9ca9 0x540 0x412a 0x9c4f 0x55e 0x4324 0x9bfe 0x564 0x451d 0x9baf 0x56c 0x4717 0x9b64 0x580 0x4910 0x9b17 0x590 0x4b0a 0x9ac9 0x59e 0x4d03 0x9a79 0x5b3 0x4efd 0x9a25 0x5be 0x50f7 0x99ca 0x5c3 0x52f0 0x9965 0x5b5 0x54ea 0x98ef 0x57f 0x56e3 0x986e 0x52e 0x58dd 0x97f8 0x4e7 0x5ad6 0x9795 0x4c4 0x5cd0 0x9743 0x4b0 0x5ec9 0x96fd 0x4ab 0x60c3 0x96bc 0x4ab 0x62bc 0x9683 0x4a0 0x64b6 0x964b 0x49c 0x66af 0x9617 0x4a2 0x68a9 0x95e6 0x4a0 0x6aa2 0x95b8 0x4a2 0x6c9c 0x958a 0x4a6 0x6e95 0x955e 0x4a6 0x708f 0x9535 0x4a6 0x7288 0x950e 0x4ac 0x7482 0x94ea 0x4bd 0x767c 0x94c7 0x4c4 0x7875 0x94a5 0x4cb 0x7a6f 0x9483 0x4c7 0x7c68 0x9465 0x4c4 0x7e62 0x944a 0x4d2 0x805b 0x942d 0x4d1 0x8255 0x9412 0x4d5 0x844e 0x93f9 0x4e7 0x8648 0x93e0 0x4ec 0x8841 0x93c7 0x4ec 0x8a3b 0x93ab 0x4dd 0x8c34 0x938a 0x4c8 0x8e2e 0x9366 0x4b4 0x9027 0x9340 0x4b0 0x9221 0x931a 0x4a0 0x941a 0x92f4 0x494 0x9614 0x92cc 0x48a 0x980d 0x92a1 0x488 0x9a07 0x9280 0x491 0x9c00 0x925d 0x492 0x9dfa 0x9240 0x49b 0x9ff4 0x921c 0x49c 0xa1ed 0x91ec 0x49c 0xa3e7 0x91ae 0x49c 0xa5e0 0x916f 0x49c 0xa7da 0x913c 0x4a5 0xa9d3 0x90fe 0x4a6 0xabcd 0x90ad 0x4a6 0xadc6 0x905c 0x489 0xafc0 0x9047 0x49c 0xb1b9 0x9038 0x4a6 0xb3b3 0x902b 0x4ba 0xb5ac 0x901f 0x4d9 0xb7a6 0x9001 0x501 0xb99f 0x8fc2 0x52f 0xbb99 0x8ed6 0x4ed 0xbd92 0x8d17 0x50c 0xbf8c 0x8ac0 0x538 0xc185 0x8780 0x59a 0xc37f 0x831d 0x636>;
		battery1_profile_t1_num = <0x64>;
		battery1_profile_t2 = <0x0 0xab6e 0x71c 0x1fa 0xaacc 0x71c 0x3f3 0xaa3e 0x712 0x5ed 0xa9be 0x71c 0x7e6 0xa93e 0x711 0x9e0 0xa8bd 0x6fd 0xbd9 0xa840 0x6f3 0xdd3 0xa7c3 0x6e9 0xfcc 0xa74c 0x6df 0x11c6 0xa6d2 0x6d7 0x13bf 0xa65d 0x6df 0x15b9 0xa5e4 0x6d6 0x17b2 0xa56f 0x6d5 0x19ac 0xa4f6 0x6cc 0x1ba5 0xa481 0x6ce 0x1d9f 0xa40b 0x6d8 0x1f98 0xa398 0x6e2 0x2192 0xa327 0x6ea 0x238b 0xa2b7 0x6ea 0x2585 0xa249 0x6ec 0x277f 0xa1d9 0x6f8 0x2978 0xa16c 0x715 0x2b72 0xa0fb 0x736 0x2d6b 0xa090 0x70a 0x2f65 0xa024 0x712 0x315e 0x9fbc 0x71d 0x3358 0x9f62 0x740 0x3551 0x9f0d 0x75c 0x374b 0x9eb7 0x783 0x3944 0x9e47 0x787 0x3b3e 0x9dbc 0x77a 0x3d37 0x9d27 0x76c 0x3f31 0x9ca1 0x76c 0x412a 0x9c33 0x773 0x4324 0x9bdc 0x784 0x451d 0x9b96 0x795 0x4717 0x9b55 0x7a8 0x4910 0x9b11 0x7a4 0x4b0a 0x9ac8 0x7a2 0x4d03 0x9a79 0x7a8 0x4efd 0x9a1f 0x79b 0x50f7 0x99bc 0x781 0x52f0 0x9952 0x756 0x54ea 0x98e4 0x71d 0x56e3 0x987a 0x6eb 0x58dd 0x9813 0x6b4 0x5ad6 0x97b5 0x68b 0x5cd0 0x9762 0x672 0x5ec9 0x971b 0x65e 0x60c3 0x96d7 0x64f 0x62bc 0x969b 0x64a 0x64b6 0x9660 0x64a 0x66af 0x962a 0x64a 0x68a9 0x95f8 0x64a 0x6aa2 0x95c8 0x650 0x6c9c 0x959b 0x65a 0x6e95 0x956f 0x65e 0x708f 0x9545 0x664 0x7288 0x951e 0x668 0x7482 0x94f9 0x66e 0x767c 0x94d7 0x678 0x7875 0x94b6 0x676 0x7a6f 0x9496 0x67f 0x7c68 0x9478 0x686 0x7e62 0x945a 0x686 0x805b 0x943d 0x68d 0x8255 0x9420 0x689 0x844e 0x9406 0x68d 0x8648 0x93ed 0x689 0x8841 0x93d7 0x68d 0x8a3b 0x93c1 0x689 0x8c34 0x93ad 0x686 0x8e2e 0x939a 0x68e 0x9027 0x9387 0x690 0x9221 0x9374 0x690 0x941a 0x935d 0x690 0x9614 0x933d 0x688 0x980d 0x9318 0x67e 0x9a07 0x92f4 0x67c 0x9c00 0x92d0 0x674 0x9dfa 0x92af 0x683 0x9ff4 0x928e 0x686 0xa1ed 0x9263 0x697 0xa3e7 0x9230 0x69a 0xa5e0 0x91f0 0x69a 0xa7da 0x91b3 0x6ab 0xa9d3 0x917d 0x6c0 0xabcd 0x913d 0x6cb 0xadc6 0x90e8 0x6d5 0xafc0 0x909e 0x6d6 0xb1b9 0x907e 0x6f2 0xb3b3 0x906a 0x719 0xb5ac 0x9058 0x74b 0xb7a6 0x9045 0x790 0xb99f 0x9026 0x7e0 0xbb99 0x8fe1 0x84e 0xbd92 0x8efb 0x88c 0xbf8c 0x8d36 0x8b5 0xc185 0x8ad6 0x97c 0xc37f 0x878c 0xaf0>;
		battery1_profile_t2_num = <0x64>;
		battery1_profile_t3 = <0x0 0xab7d 0xa0a 0x1fa 0xaac4 0xa0a 0x3f3 0xaa2f 0xa14 0x5ed 0xa9a5 0xa1e 0x7e6 0xa91e 0xa14 0x9e0 0xa89e 0xa09 0xbd9 0xa81e 0x9fe 0xdd3 0xa7a1 0x9e2 0xfcc 0xa727 0x9e1 0x11c6 0xa6af 0x9d7 0x13bf 0xa635 0x9cd 0x15b9 0xa5c0 0x9c4 0x17b2 0xa548 0x9c3 0x19ac 0xa4d3 0x9b7 0x1ba5 0xa45c 0x9a4 0x1d9f 0xa3e9 0x99e 0x1f98 0xa378 0x9a6 0x2192 0xa307 0x9a4 0x238b 0xa297 0x9a0 0x2585 0xa229 0x9b2 0x277f 0xa1ba 0x9ba 0x2978 0xa148 0x9bc 0x2b72 0xa0da 0x9c6 0x2d6b 0xa06d 0x9ce 0x2f65 0xa005 0x9d1 0x315e 0x9fa6 0x9de 0x3358 0x9f51 0xa00 0x3551 0x9f01 0xa47 0x374b 0x9ea1 0xa75 0x3944 0x9e1b 0xa61 0x3b3e 0x9d7d 0xa39 0x3d37 0x9cdf 0xa17 0x3f31 0x9c56 0xa0a 0x412a 0x9be6 0xa06 0x4324 0x9b88 0xa04 0x451d 0x9b3c 0xa0e 0x4717 0x9af7 0xa14 0x4910 0x9ab0 0xa10 0x4b0a 0x9a64 0x9fd 0x4d03 0x9a11 0x9e8 0x4efd 0x99b8 0x9cc 0x50f7 0x9953 0x999 0x52f0 0x98ed 0x96b 0x54ea 0x988a 0x93e 0x56e3 0x982b 0x911 0x58dd 0x97d3 0x8f7 0x5ad6 0x9781 0x8e3 0x5cd0 0x9735 0x8ca 0x5ec9 0x96ee 0x8b5 0x60c3 0x96ac 0x8ac 0x62bc 0x966f 0x8ac 0x64b6 0x9639 0x8b2 0x66af 0x9606 0x8b6 0x68a9 0x95d2 0x8b6 0x6aa2 0x95a3 0x8c2 0x6c9c 0x9578 0x8ca 0x6e95 0x954e 0x8d0 0x708f 0x9523 0x8da 0x7288 0x94fd 0x8f1 0x7482 0x94d7 0x8fc 0x767c 0x94b4 0x903 0x7875 0x9495 0x913 0x7a6f 0x9473 0x91a 0x7c68 0x9455 0x921 0x7e62 0x9437 0x92b 0x805b 0x941c 0x935 0x8255 0x9403 0x93f 0x844e 0x93ec 0x951 0x8648 0x93d8 0x95e 0x8841 0x93c8 0x960 0x8a3b 0x93b8 0x960 0x8c34 0x93ab 0x978 0x8e2e 0x9397 0x976 0x9027 0x9386 0x984 0x9221 0x9371 0x998 0x941a 0x935e 0x9ad 0x9614 0x9341 0x9a8 0x980d 0x9324 0x9c8 0x9a07 0x9305 0x9df 0x9c00 0x92e3 0x9f3 0x9dfa 0x92c1 0xa11 0x9ff4 0x9298 0xa41 0xa1ed 0x9265 0xa6a 0xa3e7 0x922d 0xa93 0xa5e0 0x91ee 0xabb 0xa7da 0x91b3 0xb00 0xa9d3 0x9174 0xb47 0xabcd 0x9126 0xb97 0xadc6 0x90d2 0xbd4 0xafc0 0x909c 0xc38 0xb1b9 0x9079 0xca7 0xb3b3 0x9060 0xd49 0xb5ac 0x9046 0xe3d 0xb7a6 0x9021 0xf64 0xb99f 0x8fe8 0x10d3 0xbb99 0x8f69 0x1296 0xbd92 0x8e26 0x140e 0xbf8c 0x8c1d 0x1660 0xc185 0x8950 0x1a53 0xc37f 0x85d4 0x1fea>;
		battery1_profile_t3_num = <0x64>;
		battery1_profile_t4 = <0x0 0xab9c 0x18d8 0x1fa 0xaac1 0x18d8 0x3f3 0xaa19 0x18f5 0x5ed 0xa97f 0x18cc 0x7e6 0xa8ef 0x1890 0x9e0 0xa863 0x1868 0xbd9 0xa7dc 0x1847 0xdd3 0xa759 0x17f8 0xfcc 0xa6df 0x17c6 0x11c6 0xa662 0x1796 0x13bf 0xa5ea 0x177e 0x15b9 0xa56e 0x174c 0x17b2 0xa4f6 0x171c 0x19ac 0xa480 0x1701 0x1ba5 0xa40e 0x16fb 0x1d9f 0xa39b 0x170a 0x1f98 0xa32b 0x1700 0x2192 0xa2bc 0x16f4 0x238b 0xa249 0x16da 0x2585 0xa1d8 0x16ae 0x277f 0xa168 0x1695 0x2978 0xa0f9 0x166d 0x2b72 0xa08b 0x1649 0x2d6b 0xa025 0x163d 0x2f65 0x9fc9 0x164f 0x315e 0x9f70 0x1677 0x3358 0x9f0e 0x1694 0x3551 0x9e9a 0x1688 0x374b 0x9e0f 0x1644 0x3944 0x9d69 0x15ca 0x3b3e 0x9cc0 0x155e 0x3d37 0x9c24 0x14ef 0x3f31 0x9b9c 0x14a2 0x412a 0x9b26 0x1477 0x4324 0x9ac0 0x1459 0x451d 0x9a68 0x1446 0x4717 0x9a1b 0x143a 0x4910 0x99d1 0x1428 0x4b0a 0x9988 0x1420 0x4d03 0x993c 0x1414 0x4efd 0x98ee 0x140b 0x50f7 0x989f 0x13f7 0x52f0 0x9851 0x13ec 0x54ea 0x9803 0x13f6 0x56e3 0x97b9 0x1405 0x58dd 0x9771 0x140f 0x5ad6 0x972c 0x1419 0x5cd0 0x96ea 0x1428 0x5ec9 0x96ac 0x1447 0x60c3 0x9670 0x145f 0x62bc 0x9637 0x146a 0x64b6 0x9602 0x1485 0x66af 0x95cf 0x14a7 0x68a9 0x959d 0x14c6 0x6aa2 0x956f 0x14e4 0x6c9c 0x9541 0x14f6 0x6e95 0x9516 0x1513 0x708f 0x94ed 0x1541 0x7288 0x94c6 0x156e 0x7482 0x94a1 0x1589 0x767c 0x947d 0x15a4 0x7875 0x945b 0x15bb 0x7a6f 0x943d 0x15eb 0x7c68 0x9425 0x161a 0x7e62 0x940c 0x1634 0x805b 0x93f8 0x1665 0x8255 0x93e5 0x16a9 0x844e 0x93d5 0x16e8 0x8648 0x93c0 0x1716 0x8841 0x93af 0x174e 0x8a3b 0x939d 0x17a2 0x8c34 0x938a 0x17ed 0x8e2e 0x9374 0x182c 0x9027 0x935d 0x1889 0x9221 0x9346 0x18f6 0x941a 0x932d 0x196d 0x9614 0x930f 0x19de 0x980d 0x92f0 0x1a5f 0x9a07 0x92cb 0x1b05 0x9c00 0x92a8 0x1bb0 0x9dfa 0x927d 0x1c5c 0x9ff4 0x9252 0x1d23 0xa1ed 0x9222 0x1e08 0xa3e7 0x91ee 0x1f0c 0xa5e0 0x91b9 0x200a 0xa7da 0x917e 0x212c 0xa9d3 0x9145 0x226e 0xabcd 0x9110 0x23ff 0xadc6 0x90da 0x25ba 0xafc0 0x90a5 0x279e 0xb1b9 0x9079 0x2a0f 0xb3b3 0x9044 0x2cfb 0xb5ac 0x9008 0x3062 0xb7a6 0x8fb9 0x3419 0xb99f 0x8f46 0x37e7 0xbb99 0x8e9f 0x3b03 0xbd92 0x8da0 0x3d29 0xbf8c 0x8c2d 0x3ef8 0xc185 0x8a19 0x41dd 0xc37f 0x8764 0x463c>;
		battery1_profile_t4_num = <0x64>;
		compatible = "mediatek,bat_gm30";
		g_FG_PSEUDO100_T0 = <0x62>;
		g_FG_PSEUDO100_T1 = <0x62>;
		g_FG_PSEUDO100_T2 = <0x5f>;
		g_FG_PSEUDO100_T3 = <0x5a>;
		g_FG_PSEUDO100_T4 = <0x50>;
		linux,phandle = <0x73>;
		phandle = <0x73>;
	};

	bpi_bsi_slv0@1021e000 {
		compatible = "mediatek,bpi_bsi_slv0";
		reg = <0x0 0x1021e000 0x0 0x1000>;
	};

	bpi_bsi_slv1@1021f000 {
		compatible = "mediatek,bpi_bsi_slv1";
		reg = <0x0 0x1021f000 0x0 0x6000>;
	};

	bpi_bsi_slv2@10225000 {
		compatible = "mediatek,bpi_bsi_slv2";
		reg = <0x0 0x10225000 0x0 0x1000>;
	};

	btcvsd@10001000 {
		compatible = "mediatek,audio_bt_cvsd";
		interrupts = <0x0 0xd2 0x8>;
		offset = <0xf00 0x800 0x140 0x144 0x148>;
		reg = <0x0 0x10001000 0x0 0x1000 0x0 0x18050000 0x0 0x1000 0x0 0x18080000 0x0 0x10000>;
	};

	btif@1100c000 {
		clock-names = "btifc", "apdmac";
		clocks = <0x1f 0x1a 0x1f 0x26>;
		compatible = "mediatek,btif";
		interrupts = <0x0 0x38 0x8 0x0 0x4c 0x8 0x0 0x4d 0x8>;
		reg = <0x0 0x1100c000 0x0 0x1000 0x0 0x11000880 0x0 0x80 0x0 0x11000900 0x0 0x80>;
	};

	bus_dbg@10208000 {
		compatible = "mediatek,bus_dbg-v2";
		interrupts = <0x0 0x55 0x8>;
		mediatek,bus_dbg_con_offset = <0x2fc>;
		reg = <0x0 0x10208000 0x0 0x1000 0x0 0x10001000 0x0 0x1000>;
	};

	cam@15004000 {
		compatible = "mediatek,cam";
		reg = <0x0 0x15004000 0x0 0x1000>;
	};

	cam_dma@15007000 {
		compatible = "mediatek,cam_dma";
		reg = <0x0 0x15007000 0x0 0x1000>;
	};

	cam_inner@1500d000 {
		compatible = "mediatek,cam_inner";
		reg = <0x0 0x1500d000 0x0 0x1000>;
	};

	cam_inner_dma@1500f000 {
		compatible = "mediatek,cam_inner_dma";
		reg = <0x0 0x1500f000 0x0 0x1000>;
	};

	cam_lut@15005000 {
		compatible = "mediatek,cam_lut";
		reg = <0x0 0x15005000 0x0 0x1000>;
	};

	camd@15006000 {
		compatible = "mediatek,camd";
		reg = <0x0 0x15006000 0x0 0x1000>;
	};

	camd_inner@1500e000 {
		compatible = "mediatek,camd_inner";
		reg = <0x0 0x1500e000 0x0 0x1000>;
	};

	camsv0@15050000 {
		compatible = "mediatek,camsv0";
		reg = <0x0 0x15050000 0x0 0x1000>;
	};

	camsv1@15051000 {
		compatible = "mediatek,camsv1";
		reg = <0x0 0x15051000 0x0 0x1000>;
	};

	camsys@15000000 {
		#clock-cells = <0x1>;
		compatible = "mediatek,camsys", "syscon";
		linux,phandle = <0x3c>;
		phandle = <0x3c>;
		reg = <0x0 0x15000000 0x0 0x1000>;
	};

	charger {
		ac_charger_current = <0x1e8480>;
		ac_charger_input_current = <0x1e8480>;
		algorithm_name = "SwitchCharging";
		apple_1_0a_charger_current = <0x9eb10>;
		apple_2_1a_charger_current = <0xc3500>;
		battery_cv = <0x432380>;
		bif_cv_under_threshold2 = <0x43e6d0>;
		bif_threshold1 = <0x40d990>;
		bif_threshold2 = <0x419ce0>;
		cable_imp_threshold = <0x2bb>;
		charging_host_charger_current = <0xf4240>;
		chg1_ta_ac_charger_current = <0x16e360>;
		chg2_ta_ac_charger_current = <0x16e360>;
		compatible = "mediatek,charger";
		enable_min_charge_temp;
		enable_sw_jeita;
		jeita_temp_above_t4_cv = <0x3ebe80>;
		jeita_temp_below_t0_cv = <0x432380>;
		jeita_temp_t0_to_t1_cv = <0x432380>;
		jeita_temp_t1_to_t2_cv = <0x432380>;
		jeita_temp_t2_to_t3_cv = <0x432380>;
		jeita_temp_t3_to_t4_cv = <0x3ebe80>;
		linux,phandle = <0xa0>;
		max_charge_temp = <0x35>;
		max_charge_temp_minus_x_degree = <0x34>;
		max_charger_voltage = <0x632ea0>;
		min_charge_temp = <0x0>;
		min_charge_temp_plus_x_degree = <0x1>;
		min_charger_voltage = <0x4630c0>;
		non_std_ac_charger_current = <0x7a120>;
		pe20_ichg_level_threshold = <0xf4240>;
		pe40_dual_charger_chg1_current = <0x1e8480>;
		pe40_dual_charger_chg2_current = <0x1e8480>;
		pe40_dual_charger_input_current = <0x2dc6c0>;
		pe40_r_cable_1a_lower = <0x212>;
		pe40_r_cable_2a_lower = <0x186>;
		pe40_r_cable_3a_lower = <0xfc>;
		pe40_single_charger_current = <0x2dc6c0>;
		pe40_single_charger_input_current = <0x2dc6c0>;
		pe40_stop_battery_soc = <0x50>;
		pe_ichg_level_threshold = <0xf4240>;
		phandle = <0xa0>;
		power_path_support;
		ta_12v_support;
		ta_9v_support;
		ta_ac_12v_input_current = <0x30d400>;
		ta_ac_7v_input_current = <0x30d400>;
		ta_ac_9v_input_current = <0x30d400>;
		ta_ac_charger_current = <0x2dc6c0>;
		ta_start_battery_soc = <0x0>;
		ta_stop_battery_soc = <0x55>;
		temp_neg_10_thres = <0x2>;
		temp_t0_thres = <0x1>;
		temp_t0_thres_plus_x_degree = <0x1>;
		temp_t1_thres = <0x1>;
		temp_t1_thres_plus_x_degree = <0x1>;
		temp_t2_thres = <0xf>;
		temp_t2_thres_plus_x_degree = <0x10>;
		temp_t3_thres = <0x2d>;
		temp_t3_thres_minus_x_degree = <0x2c>;
		temp_t4_thres = <0x37>;
		temp_t4_thres_minus_x_degree = <0x33>;
		termination_current = <0x27100>;
		usb_charger_current = <0x7a120>;
		usb_charger_current_configured = <0x7a120>;
		usb_charger_current_suspend = <0x0>;
		usb_charger_current_unconfigured = <0x11170>;
		vbat_cable_imp_threshold = <0x3b8260>;
	};

	chipid@08000000 {
		compatible = "mediatek,chipid";
		reg = <0x0 0x8000000 0x0 0x4 0x0 0x8000004 0x0 0x4 0x0 0x8000008 0x0 0x4 0x0 0x800000c 0x0 0x4>;
	};

	chosen {
		bootargs = "console=tty0 console=ttyS0,921600n1 vmalloc=496M slub_max_order=0 slub_debug=OFZPU page_owner=on androidboot.hardware=mt6761 maxcpus=8 firmware_class.path=/vendor/firmware loop.max_part=7";
		linux,phandle = <0x45>;
		phandle = <0x45>;
	};

	clocks {

		clk26m {
			#clock-cells = <0x0>;
			clock-frequency = <0x18cba80>;
			compatible = "fixed-clock";
			linux,phandle = <0x1b>;
			phandle = <0x1b>;
		};

		clk32k {
			#clock-cells = <0x0>;
			clock-frequency = <0x7d00>;
			compatible = "fixed-clock";
			linux,phandle = <0x1a>;
			phandle = <0x1a>;
		};
	};

	consys@18002000 {
		#address-cells = <0x2>;
		#size-cells = <0x2>;
		clock-names = "conn";
		clocks = <0x20 0x1>;
		compatible = "mediatek,mt6761-consys";
		interrupts = <0x0 0xd3 0x8 0x0 0xd5 0x8 0x0 0xd6 0x1>;
		linux,phandle = <0xf>;
		phandle = <0xf>;
		reg = <0x0 0x18002000 0x0 0x1000 0x0 0x10007000 0x0 0x100 0x0 0x10001000 0x0 0x1000 0x0 0x10006000 0x0 0x1000 0x0 0x18007000 0x0 0x1000 0x0 0x180b1000 0x0 0x1000 0x0 0x180a3000 0x0 0x1000 0x0 0x180a5000 0x0 0x800 0x0 0x180c1000 0x0 0x1000 0x0 0x18004000 0x0 0x1000>;
	};

	cpu_dbgapb@0d410000 {
		compatible = "mediatek,hw_dbg";
		linux,phandle = <0x46>;
		num = <0x8>;
		phandle = <0x46>;
		reg = <0x0 0xd410000 0x0 0x1000 0x0 0xd510000 0x0 0x1000 0x0 0xd610000 0x0 0x1000 0x0 0xd710000 0x0 0x1000 0x0 0xd810000 0x0 0x1000 0x0 0xd910000 0x0 0x1000 0x0 0xda10000 0x0 0x1000 0x0 0xdb10000 0x0 0x1000>;
	};

	cpus {
		#address-cells = <0x1>;
		#size-cells = <0x0>;

		cpu-map {

			cluster0 {

				core0 {
					cpu = <0x9>;
				};

				core1 {
					cpu = <0xa>;
				};

				core2 {
					cpu = <0xb>;
				};

				core3 {
					cpu = <0xc>;
				};
			};
		};

		cpu@000 {
			clock-frequency = <0x8b799100>;
			compatible = "arm,cortex-a53";
			cpu-idle-states = <0x2 0x3 0x4 0x5 0x6 0x7 0x8>;
			device_type = "cpu";
			enable-method = "psci";
			linux,phandle = <0x9>;
			phandle = <0x9>;
			reg = <0x0>;
		};

		cpu@001 {
			clock-frequency = <0x8b799100>;
			compatible = "arm,cortex-a53";
			cpu-idle-states = <0x2 0x3 0x4 0x5 0x6 0x7 0x8>;
			device_type = "cpu";
			enable-method = "psci";
			linux,phandle = <0xa>;
			phandle = <0xa>;
			reg = <0x1>;
		};

		cpu@002 {
			clock-frequency = <0x8b799100>;
			compatible = "arm,cortex-a53";
			cpu-idle-states = <0x2 0x3 0x4 0x5 0x6 0x7 0x8>;
			device_type = "cpu";
			enable-method = "psci";
			linux,phandle = <0xb>;
			phandle = <0xb>;
			reg = <0x2>;
		};

		cpu@003 {
			clock-frequency = <0x8b799100>;
			compatible = "arm,cortex-a53";
			cpu-idle-states = <0x2 0x3 0x4 0x5 0x6 0x7 0x8>;
			device_type = "cpu";
			enable-method = "psci";
			linux,phandle = <0xc>;
			phandle = <0xc>;
			reg = <0x3>;
		};

		idle-states {
			entry-method = "arm,psci";

			dpidle {
				arm,psci-suspend-param = <0x1010004>;
				compatible = "arm,idle-state";
				entry-latency-us = <0x320>;
				exit-latency-us = <0x3e8>;
				linux,phandle = <0x7>;
				min-residency-us = <0x7d0>;
				phandle = <0x7>;
			};

			mcdi-cluster {
				arm,psci-suspend-param = <0x1010001>;
				compatible = "arm,idle-state";
				entry-latency-us = <0x258>;
				exit-latency-us = <0x258>;
				linux,phandle = <0x4>;
				min-residency-us = <0x4b0>;
				phandle = <0x4>;
			};

			mcdi-cpu {
				arm,psci-suspend-param = <0x10001>;
				compatible = "arm,idle-state";
				entry-latency-us = <0x258>;
				exit-latency-us = <0x258>;
				linux,phandle = <0x3>;
				min-residency-us = <0x4b0>;
				phandle = <0x3>;
			};

			sodi {
				arm,psci-suspend-param = <0x1010002>;
				compatible = "arm,idle-state";
				entry-latency-us = <0x320>;
				exit-latency-us = <0x3e8>;
				linux,phandle = <0x5>;
				min-residency-us = <0x7d0>;
				phandle = <0x5>;
			};

			sodi3 {
				arm,psci-suspend-param = <0x1010003>;
				compatible = "arm,idle-state";
				entry-latency-us = <0x320>;
				exit-latency-us = <0x3e8>;
				linux,phandle = <0x6>;
				min-residency-us = <0x7d0>;
				phandle = <0x6>;
			};

			standby {
				arm,psci-suspend-param = <0x1>;
				compatible = "arm,idle-state";
				entry-latency-us = <0x258>;
				exit-latency-us = <0x258>;
				linux,phandle = <0x2>;
				min-residency-us = <0x4b0>;
				phandle = <0x2>;
			};

			suspend {
				arm,psci-suspend-param = <0x1010005>;
				compatible = "arm,idle-state";
				entry-latency-us = <0x320>;
				exit-latency-us = <0x3e8>;
				linux,phandle = <0x8>;
				min-residency-us = <0x7d0>;
				phandle = <0x8>;
			};
		};
	};

	cq_dma@10212000 {
		clock-names = "cqdma";
		clocks = <0x1f 0x43>;
		compatible = "mediatek,mt-cqdma-v1";
		interrupts = <0x0 0x39 0x8 0x0 0x3a 0x8 0x0 0x3b 0x8>;
		keep_clock_ao = "yes";
		nr_channel = <0x3>;
		reg = <0x0 0x10212000 0x0 0x80 0x0 0x10212080 0x0 0x80 0x0 0x10212100 0x0 0x68>;
	};

	dbg_apmcu_mp0@0d400000 {
		compatible = "mediatek,dbg_apmcu_mp0";
		reg = <0x0 0xd400000 0x0 0x1000>;
	};

	dbg_apmcu_mp0@0d410000 {
		compatible = "mediatek,dbg_apmcu_mp0";
		reg = <0x0 0xd410000 0x0 0x1000>;
	};

	dbg_apmcu_mp0@0d420000 {
		compatible = "mediatek,dbg_apmcu_mp0";
		reg = <0x0 0xd420000 0x0 0x1000>;
	};

	dbg_apmcu_mp0@0d430000 {
		compatible = "mediatek,dbg_apmcu_mp0";
		reg = <0x0 0xd430000 0x0 0x1000>;
	};

	dbg_apmcu_mp0@0d440000 {
		compatible = "mediatek,dbg_apmcu_mp0";
		reg = <0x0 0xd440000 0x0 0x1000>;
	};

	dbg_apmcu_mp0@0d510000 {
		compatible = "mediatek,dbg_apmcu_mp0";
		reg = <0x0 0xd510000 0x0 0x1000>;
	};

	dbg_apmcu_mp0@0d520000 {
		compatible = "mediatek,dbg_apmcu_mp0";
		reg = <0x0 0xd520000 0x0 0x1000>;
	};

	dbg_apmcu_mp0@0d530000 {
		compatible = "mediatek,dbg_apmcu_mp0";
		reg = <0x0 0xd530000 0x0 0x1000>;
	};

	dbg_apmcu_mp0@0d540000 {
		compatible = "mediatek,dbg_apmcu_mp0";
		reg = <0x0 0xd540000 0x0 0x1000>;
	};

	dbg_apmcu_mp0@0d610000 {
		compatible = "mediatek,dbg_apmcu_mp0";
		reg = <0x0 0xd610000 0x0 0x1000>;
	};

	dbg_apmcu_mp0@0d620000 {
		compatible = "mediatek,dbg_apmcu_mp0";
		reg = <0x0 0xd620000 0x0 0x1000>;
	};

	dbg_apmcu_mp0@0d630000 {
		compatible = "mediatek,dbg_apmcu_mp0";
		reg = <0x0 0xd630000 0x0 0x1000>;
	};

	dbg_apmcu_mp0@0d640000 {
		compatible = "mediatek,dbg_apmcu_mp0";
		reg = <0x0 0xd640000 0x0 0x1000>;
	};

	dbg_apmcu_mp0@0d710000 {
		compatible = "mediatek,dbg_apmcu_mp0";
		reg = <0x0 0xd710000 0x0 0x1000>;
	};

	dbg_apmcu_mp0@0d720000 {
		compatible = "mediatek,dbg_apmcu_mp0";
		reg = <0x0 0xd720000 0x0 0x1000>;
	};

	dbg_apmcu_mp0@0d730000 {
		compatible = "mediatek,dbg_apmcu_mp0";
		reg = <0x0 0xd730000 0x0 0x1000>;
	};

	dbg_apmcu_mp0@0d740000 {
		compatible = "mediatek,dbg_apmcu_mp0";
		reg = <0x0 0xd740000 0x0 0x1000>;
	};

	dbg_apmcu_mp1@0d800000 {
		compatible = "mediatek,dbg_apmcu_mp1";
		reg = <0x0 0xd800000 0x0 0x1000>;
	};

	dbg_apmcu_mp1@0d810000 {
		compatible = "mediatek,dbg_apmcu_mp1";
		reg = <0x0 0xd810000 0x0 0x1000>;
	};

	dbg_apmcu_mp1@0d820000 {
		compatible = "mediatek,dbg_apmcu_mp1";
		reg = <0x0 0xd820000 0x0 0x1000>;
	};

	dbg_apmcu_mp1@0d830000 {
		compatible = "mediatek,dbg_apmcu_mp1";
		reg = <0x0 0xd830000 0x0 0x1000>;
	};

	dbg_apmcu_mp1@0d840000 {
		compatible = "mediatek,dbg_apmcu_mp1";
		reg = <0x0 0xd840000 0x0 0x1000>;
	};

	dbg_apmcu_mp1@0d910000 {
		compatible = "mediatek,dbg_apmcu_mp1";
		reg = <0x0 0xd910000 0x0 0x1000>;
	};

	dbg_apmcu_mp1@0d920000 {
		compatible = "mediatek,dbg_apmcu_mp1";
		reg = <0x0 0xd920000 0x0 0x1000>;
	};

	dbg_apmcu_mp1@0d930000 {
		compatible = "mediatek,dbg_apmcu_mp1";
		reg = <0x0 0xd930000 0x0 0x1000>;
	};

	dbg_apmcu_mp1@0d940000 {
		compatible = "mediatek,dbg_apmcu_mp1";
		reg = <0x0 0xd940000 0x0 0x1000>;
	};

	dbg_apmcu_mp1@0da10000 {
		compatible = "mediatek,dbg_apmcu_mp1";
		reg = <0x0 0xda10000 0x0 0x1000>;
	};

	dbg_apmcu_mp1@0da20000 {
		compatible = "mediatek,dbg_apmcu_mp1";
		reg = <0x0 0xda20000 0x0 0x1000>;
	};

	dbg_apmcu_mp1@0da30000 {
		compatible = "mediatek,dbg_apmcu_mp1";
		reg = <0x0 0xda30000 0x0 0x1000>;
	};

	dbg_apmcu_mp1@0da40000 {
		compatible = "mediatek,dbg_apmcu_mp1";
		reg = <0x0 0xda40000 0x0 0x1000>;
	};

	dbg_apmcu_mp1@0db10000 {
		compatible = "mediatek,dbg_apmcu_mp1";
		reg = <0x0 0xdb10000 0x0 0x1000>;
	};

	dbg_apmcu_mp1@0db20000 {
		compatible = "mediatek,dbg_apmcu_mp1";
		reg = <0x0 0xdb20000 0x0 0x1000>;
	};

	dbg_apmcu_mp1@0db30000 {
		compatible = "mediatek,dbg_apmcu_mp1";
		reg = <0x0 0xdb30000 0x0 0x1000>;
	};

	dbg_apmcu_mp1@0db40000 {
		compatible = "mediatek,dbg_apmcu_mp1";
		reg = <0x0 0xdb40000 0x0 0x1000>;
	};

	dbg_cti@0d020000 {
		compatible = "mediatek,dbg_cti";
		reg = <0x0 0xd020000 0x0 0x10000>;
	};

	dbg_dem@0d0a0000 {
		compatible = "mediatek,dbg_dem";
		interrupts = <0x0 0x54 0x8>;
		reg = <0x0 0xd0a0000 0x0 0x10000>;
	};

	dbg_etr@0d030000 {
		compatible = "mediatek,dbg_etr";
		reg = <0x0 0xd030000 0x0 0x10000>;
	};

	dbg_funnel@0d040000 {
		compatible = "mediatek,dbg_funnel";
		reg = <0x0 0xd040000 0x0 0x10000>;
	};

	dbg_mdsys1@0d0c0000 {
		compatible = "mediatek,dbg_mdsys1";
		reg = <0x0 0xd0c0000 0x0 0x40000>;
	};

	devapc@10207000 {
		clock-names = "devapc-infra-clock";
		clocks = <0x1f 0x28>;
		compatible = "mediatek,devapc";
		interrupts = <0x0 0x56 0x8>;
		reg = <0x0 0x10207000 0x0 0x1000>;
	};

	dfd@10200b00 {
		compatible = "mediatek,dfd";
		mediatek,chain_length = <0x61a8>;
		mediatek,enabled = <0x1>;
		mediatek,rg_dfd_timeout = <0xa0>;
		reg = <0x0 0x10200b00 0x0 0x10000>;
	};

	disp_aal0@14011000 {
		compatible = "mediatek,disp_aal0";
		interrupts = <0x0 0xa6 0x8>;
		reg = <0x0 0x14011000 0x0 0x1000>;
	};

	disp_ccorr0@14010000 {
		compatible = "mediatek,disp_ccorr0";
		interrupts = <0x0 0xa5 0x8>;
		reg = <0x0 0x14010000 0x0 0x1000>;
	};

	disp_color0@1400f000 {
		compatible = "mediatek,disp_color0";
		interrupts = <0x0 0xa4 0x8>;
		linux,phandle = <0x28>;
		phandle = <0x28>;
		reg = <0x0 0x1400f000 0x0 0x1000>;
	};

	disp_dither0@14013000 {
		compatible = "mediatek,disp_dither0";
		interrupts = <0x0 0xa8 0x8>;
		reg = <0x0 0x14013000 0x0 0x1000>;
	};

	disp_gamma0@14012000 {
		compatible = "mediatek,disp_gamma0";
		interrupts = <0x0 0xa7 0x8>;
		reg = <0x0 0x14012000 0x0 0x1000>;
	};

	disp_mutex0@14001000 {
		compatible = "mediatek,disp_mutex0";
		interrupts = <0x0 0x9a 0x8>;
		linux,phandle = <0x2a>;
		phandle = <0x2a>;
		reg = <0x0 0x14001000 0x0 0x1000>;
	};

	disp_ovl0@1400b000 {
		compatible = "mediatek,disp_ovl0";
		interrupts = <0x0 0xa1 0x8>;
		reg = <0x0 0x1400b000 0x0 0x1000>;
	};

	disp_ovl0_2l@1400c000 {
		compatible = "mediatek,disp_ovl0_2l";
		interrupts = <0x0 0xad 0x8>;
		reg = <0x0 0x1400c000 0x0 0x1000>;
	};

	disp_pwm@1100e000 {
		compatible = "mediatek,disp_pwm";
		reg = <0x0 0x1100e000 0x0 0x1000>;
	};

	disp_rdma0@1400d000 {
		compatible = "mediatek,disp_rdma0";
		interrupts = <0x0 0xa2 0x8>;
		reg = <0x0 0x1400d000 0x0 0x1000>;
	};

	disp_rsz0@14015000 {
		compatible = "mediatek,disp_rsz0";
		interrupts = <0x0 0xdc 0x8>;
		reg = <0x0 0x14015000 0x0 0x1000>;
	};

	disp_wdma0@1400e000 {
		compatible = "mediatek,disp_wdma0";
		interrupts = <0x0 0xa3 0x8>;
		reg = <0x0 0x1400e000 0x0 0x1000>;
	};

	dispsys {
		clock-names = "MMSYS_MTCMOS", "MMSYS_SMI_COMMON", "MMSYS_SMI_LARB0", "MMSYS_GALS_COMM0", "MMSYS_GALS_COMM1", "MMSYS_DISP_OVL0", "MMSYS_DISP_OVL0_2L", "MMSYS_DISP_RDMA0", "MMSYS_DISP_WDMA0", "MMSYS_DISP_COLOR0", "MMSYS_DISP_CCORR0", "MMSYS_DISP_AAL0", "MMSYS_DISP_GAMMA0", "MMSYS_DISP_DITHER0", "MMSYS_DSI0_MM_CK", "MMSYS_DSI0_IF_CK", "MMSYS_26M", "MMSYS_DISP_RSZ0", "APMIXED_MIPI_26M", "TOP_MUX_DISP_PWM", "DISP_PWM", "TOP_26M", "TOP_UNIVPLL2_D4", "TOP_ULPOSC1_D2", "TOP_ULPOSC1_D8";
		clocks = <0x20 0x3 0x21 0x13 0x21 0x14 0x21 0x15 0x21 0x16 0x21 0x7 0x21 0x8 0x21 0xa 0x21 0xb 0x21 0xc 0x21 0xd 0x21 0xe 0x21 0xf 0x21 0x10 0x21 0x11 0x21 0x1c 0x21 0x1d 0x21 0x9 0x3b 0x13 0x19 0x7c 0x1f 0x31 0x1b 0x19 0x1e 0x19 0x2f 0x19 0x31>;
		compatible = "mediatek,dispsys";
		mediatek,larb = <0x1c>;
	};

	dma-controller@11000580 {
		#dma-cells = <0x1>;
		clock-names = "apdma";
		clocks = <0x1f 0x26>;
		compatible = "mediatek,mt6577-uart-dma";
		interrupts = <0x0 0x35 0x8 0x0 0x36 0x8 0x0 0x37 0x8 0x0 0x3c 0x8>;
		linux,phandle = <0x2c>;
		phandle = <0x2c>;
		reg = <0x0 0x11000680 0x0 0x80 0x0 0x11000700 0x0 0x80 0x0 0x11000780 0x0 0x80 0x0 0x11000800 0x0 0x80>;
	};

	dramc@1022a000 {
		compatible = "mediatek,dramc";
		reg = <0x0 0x1022a000 0x0 0x2000 0x0 0x10232000 0x0 0x2000 0x0 0x1022c000 0x0 0x1000 0x0 0x10234000 0x0 0x1000 0x0 0x10228000 0x0 0x2000 0x0 0x10230000 0x0 0x2000 0x0 0x1022e000 0x0 0x1000 0x0 0x10236000 0x0 0x1000>;
	};

	dsi0@14014000 {
		compatible = "mediatek,dsi0";
		interrupts = <0x0 0xa9 0x8>;
		reg = <0x0 0x14014000 0x0 0x1000>;
	};

	dsi_te {
		compatible = "mediatek, DSI_TE-eint";
		linux,phandle = <0x94>;
		phandle = <0x94>;
		status = "disabled";
	};

	dvfsp@00110800 {
		compatible = "mediatek,mt6761-dvfsp";
		reg = <0x0 0x110800 0x0 0x1400 0x0 0x110800 0x0 0x1400>;
	};

	dvfsp@10227000 {
		compatible = "mediatek,dvfsp";
		reg = <0x0 0x10227000 0x0 0x1000>;
	};

	dvfsrc@10012000 {
		compatible = "mediatek,dvfsrc";
		reg = <0x0 0x10012000 0x0 0x1000 0x0 0x110780 0x0 0x80>;
	};

	dxcc_sec@10210000 {
		compatible = "mediatek,dxcc_sec";
		interrupts = <0x0 0x6a 0x4>;
		reg = <0x0 0x10210000 0x0 0x1000>;
	};

	dynamic_options {
		compatible = "mediatek,dynamic_options";
		linux,phandle = <0x9d>;
		phandle = <0x9d>;
	};

	eem_fsm@1100b000 {
		compatible = "mediatek,eem_fsm";
		interrupts = <0x0 0x45 0x8>;
		reg = <0x0 0x1100b000 0x0 0x1000>;
	};

	efuse_dbg@10004000 {
		compatible = "mediatek,efuse_dbg";
		reg = <0x0 0x10004000 0x0 0x1000>;
	};

	efusec@11c50000 {
		compatible = "mediatek,efusec";
		reg = <0x0 0x11c50000 0x0 0x10000>;
	};

	emi@10219000 {
		compatible = "mediatek,emi";
		interrupts = <0x0 0x58 0x8>;
		reg = <0x0 0x10219000 0x0 0x1000 0x0 0x10226000 0x0 0x1000 0x0 0x1022d000 0x0 0x1000 0x0 0x10235000 0x0 0x1000>;
	};

	fdvt@1500b000 {
		clock-names = "FD_CLK_CAM_FDVT";
		clocks = <0x3c 0x6>;
		compatible = "mediatek,fdvt";
		interrupts = <0x0 0xb6 0x8>;
		reg = <0x0 0x1500b000 0x0 0x1000>;
	};

	fhctl@1000ce00 {
		compatible = "mediatek,fhctl";
		reg = <0x0 0x1000ce00 0x0 0x200>;
	};

	firmware {

		android {
			compatible = "android,firmware";

			fstab {
				compatible = "android,fstab";

				vendor {
					compatible = "android,vendor";
					dev = "/dev/block/platform/bootdevice/by-name/vendor";
					fsmgr_flags = "wait,avb";
					mnt_flags = "ro";
					type = "ext4";
				};
			};

			vbmeta {
				compatible = "android,vbmeta";
				parts = "vbmeta,boot,system,vendor,recovery";
			};
		};
	};

	flashlight_core {
		compatible = "mediatek,flashlight_core";
		linux,phandle = <0x97>;
		phandle = <0x97>;
	};

	flashlights_aw3644 {
		compatible = "mediatek,flashlights_aw3644";
		linux,phandle = <0x99>;
		phandle = <0x99>;
	};

	flashlights_mt6370 {
		compatible = "mediatek,flashlights_mt6370";
		decouple = <0x0>;
		linux,phandle = <0x98>;
		phandle = <0x98>;

		channel@1 {
			ct = <0x0>;
			part = <0x0>;
			type = <0x0>;
		};

		channel@2 {
			ct = <0x1>;
			part = <0x0>;
			type = <0x0>;
		};
	};

	gauge_timer {
		compatible = "mediatek,gauge_timer_service";
	};

	gce@10238000 {
		#clock-cells = <0x1>;
		ap_dma_base = <0x18010000 0x17 0xffff0000>;
		audio_base = <0x17000000 0x12 0xffff0000>;
		buf_underrun_event_0 = <0x8c>;
		camsv_0_pass1_done = <0x106>;
		camsv_1_pass1_done = <0x107>;
		camsys1_base = <0x180a0000 0x1c 0xffff0000>;
		camsys2_base = <0x180b0000 0x1d 0xffff0000>;
		camsys_base = <0x18080000 0x1b 0xffff0000>;
		clock-names = "GCE", "GCE_TIMER";
		clocks = <0x1f 0x9 0x1f 0x18>;
		compatible = "mediatek,gce", "syscon";
		conn_peri_base = <0x18820000 0x7 0xffff0000>;
		dip_cq_thread0_frame_done = <0x103>;
		dip_cq_thread1_frame_done = <0x102>;
		dip_cq_thread2_frame_done = <0x101>;
		disp_2l_ovl0_frame_done = <0x1c>;
		disp_2l_ovl0_sof = <0x8>;
		disp_aal0_frame_done = <0x22>;
		disp_aal0_sof = <0xd>;
		disp_ccorr0_frame_done = <0x21>;
		disp_ccorr0_sof = <0xc>;
		disp_color0_frame_done = <0x20>;
		disp_color0_sof = <0xb>;
		disp_dither0_frame_done = <0x24>;
		disp_dither0_sof = <0xf>;
		disp_dither_base = <0x14010000 0x2 0xffff0000>;
		disp_dsi0_frame_done = <0x25>;
		disp_dsi0_sof = <0x10>;
		disp_gamma0_frame_done = <0x23>;
		disp_gamma0_sof = <0xe>;
		disp_ovl0_frame_done = <0x1b>;
		disp_ovl0_frame_rst_done_pusle = <0x98>;
		disp_ovl0_sof = <0x7>;
		disp_pwm0_sof = <0x13>;
		disp_rdma0_frame_done = <0x1e>;
		disp_rdma0_sof = <0x9>;
		disp_rsz0_frame_done = <0x1d>;
		disp_rsz0_sof = <0x11>;
		disp_wdma0_frame_done = <0x1f>;
		disp_wdma0_rst_done = <0x93>;
		disp_wdma0_sof = <0xa>;
		dsi0_done_event = <0x8f>;
		dsi0_irq_event = <0x8e>;
		dsi0_te_event = <0x8d>;
		g3d_config_base = <0x13000000 0x0 0xffff0000>;
		gce_base = <0x18020000 0x18 0xffff0000>;
		gcpu_base = <0x10050000 0xf 0xffff0000>;
		img_dl_relay_sof = <0x12>;
		imgsys_base = <0x15020000 0x4 0xffff0000>;
		infra_na3_base = <0x10010000 0xb 0xffff0000>;
		infra_na4_base = <0x10020000 0xc 0xffff0000>;
		interrupts = <0x0 0x62 0x8>;
		isp_frame_done_p1_0 = <0x105>;
		isp_frame_done_p1_1 = <0x104>;
		jpgdec_done = <0x123>;
		jpgenc_done = <0x122>;
		kp_base = <0x18840000 0x9 0xffff0000>;
		linux,phandle = <0x74>;
		max_prefetch_cnt = <0x1>;
		mboxes = <0x2b 0x0 0x0 0x4 0x2b 0x1 0x0 0x4 0x2b 0x2 0x0 0x5 0x2b 0x3 0x0 0x4 0x2b 0x4 0x0 0x4 0x2b 0x5 0x0 0x4 0x2b 0x6 0xc8 0x3 0x2b 0x7 0xffffffff 0x2 0x2b 0x8 0x0 0x1 0x2b 0x9 0x0 0x1 0x2b 0xa 0x0 0x1 0x2b 0xb 0x0 0x1 0x2b 0xc 0x0 0x1 0x2b 0xd 0x0 0x1 0x2b 0xe 0x0 0x1 0x2b 0xf 0x0 0x1>;
		mcucfg_base = <0x10040000 0xe 0xffff0000>;
		mdp_ccorr0 = <0x29>;
		mdp_ccorr0_frame_done = <0x15>;
		mdp_ccorr0_sof = <0x1>;
		mdp_color0 = <0x28>;
		mdp_rdma0 = <0x22>;
		mdp_rdma0_frame_done = <0x14>;
		mdp_rdma0_rst_done = <0x97>;
		mdp_rdma0_sof = <0x0>;
		mdp_rsz0 = <0x23>;
		mdp_rsz0_frame_done = <0x16>;
		mdp_rsz0_sof = <0x2>;
		mdp_rsz1 = <0x24>;
		mdp_rsz1_frame_done = <0x17>;
		mdp_rsz1_sof = <0x3>;
		mdp_tdshp0 = <0x27>;
		mdp_tdshp0_frame_done = <0x1a>;
		mdp_tdshp0_sof = <0x6>;
		mdp_wdma0 = <0x25>;
		mdp_wdma_frame_done = <0x19>;
		mdp_wdma_rst_done = <0x94>;
		mdp_wdma_sof = <0x4>;
		mdp_wrot0 = <0x26>;
		mdp_wrot0_rst_done = <0x95>;
		mdp_wrot0_sof = <0x5>;
		mdp_wrot0_write_frame_done = <0x18>;
		mediatek,mailbox-gce = <0x2b>;
		mipitx0_base = <0x11c80000 0x63 0xffff0000>;
		mm_mutex = <0x2a>;
		mm_na_base = <0x14020000 0x3 0xffff0000>;
		mmsys_config = <0x21>;
		mmsys_config_base = <0x14000000 0x1 0xffff0000>;
		msdc2_base = <0x17020000 0x14 0xffff0000>;
		msdc3_base = <0x18000000 0x16 0xffff0000>;
		phandle = <0x74>;
		prefetch_size = <0x60>;
		pwm_sw_base = <0x1100e000 0x63 0xffff0000>;
		reg = <0x0 0x10238000 0x0 0x4000>;
		scp_base = <0x10030000 0xd 0xffff0000>;
		scp_sram_base = <0x10000000 0xa 0xffff0000>;
		seninf_0_fifo_full = <0x108>;
		seninf_1_fifo_full = <0x109>;
		seninf_2_fifo_full = <0x10a>;
		seninf_3_fifo_full = <0x10b>;
		seninf_4_fifo_full = <0x10c>;
		seninf_5_fifo_full = <0x10d>;
		seninf_6_fifo_full = <0x10e>;
		seninf_7_fifo_full = <0x10f>;
		sram_share_cnt = <0x1>;
		sram_share_engine = <0xa>;
		sram_share_event = <0x2c6>;
		sram_size_cpr_64 = <0x40>;
		stream_done_0 = <0x82>;
		stream_done_1 = <0x83>;
		stream_done_2 = <0x84>;
		stream_done_3 = <0x85>;
		stream_done_4 = <0x86>;
		stream_done_5 = <0x87>;
		stream_done_6 = <0x88>;
		stream_done_7 = <0x89>;
		stream_done_8 = <0x8a>;
		stream_done_9 = <0x8b>;
		topckgen_base = <0x18830000 0x8 0xffff0000>;
		usb0_base = <0x10200000 0x10 0xffff0000>;
		usb_sif_base = <0x10280000 0x11 0xffff0000>;
		vdec1_base = <0x17030000 0x15 0xffff0000>;
		vdec2_base = <0x18040000 0x19 0xffff0000>;
		vdec3_base = <0x18050000 0x1a 0xffff0000>;
		vdec_base = <0x17010000 0x13 0xffff0000>;
		vdec_gcon_base = <0x18800000 0x5 0xffff0000>;
		venc_128byte_cnt_done = <0x125>;
		venc_done = <0x121>;
		venc_gcon_base = <0x18810000 0x6 0xffff0000>;
		venc_mb_done = <0x124>;
	};

	gce_mbox@10238000 {
		#gce-event-cells = <0x1>;
		#gce-subsys-cells = <0x2>;
		#mbox-cells = <0x3>;
		clock-names = "gce", "GCE_TIMER";
		clocks = <0x1f 0x9 0x1f 0x18>;
		compatible = "mediatek,mailbox-gce";
		interrupts = <0x0 0x62 0x8>;
		linux,phandle = <0x2b>;
		phandle = <0x2b>;
		reg = <0x0 0x10238000 0x0 0x4000>;
	};

	gic500@0c000000 {
		compatible = "mediatek,gic500";
		reg = <0x0 0xc000000 0x0 0x400000>;
	};

	gic_cpu@0c400000 {
		compatible = "mediatek,gic_cpu";
		reg = <0x0 0xc400000 0x0 0x40000>;
	};

	gpio {
		compatible = "mediatek,gpio_usage_mapping";
		linux,phandle = <0x4c>;
		phandle = <0x4c>;
	};

	gpio@10005000 {
		compatible = "mediatek,gpio";
		linux,phandle = <0x4d>;
		phandle = <0x4d>;
		reg = <0x0 0x10005000 0x0 0x1000>;
	};

	gpufreq {
		clock-names = "clk_mux", "clk_main_parent", "clk_sub_parent", "mtcmos_mfg_async", "mtcmos_mfg", "mtcmos_mfg_core0";
		clocks = <0x19 0x6d 0x19 0x28 0x1b 0x20 0x7 0x20 0x4 0x20 0x6>;
		compatible = "mediatek,mt6761-gpufreq";
	};

	hacc@1000a000 {
		compatible = "mediatek,hacc";
		interrupts = <0x0 0x85 0x8>;
		reg = <0x0 0x1000a000 0x0 0x1000>;
	};

	i2c0@11007000 {
		aed = <0x1a>;
		clock-div = <0x5>;
		clock-names = "main", "dma";
		clocks = <0x1f 0xb 0x1f 0x26>;
		compatible = "mediatek,i2c";
		id = <0x0>;
		interrupts = <0x0 0x1c 0x8>;
		linux,phandle = <0x7a>;
		mediatek,hs_only;
		phandle = <0x7a>;
		reg = <0x0 0x11007000 0x0 0x1000 0x0 0x11000080 0x0 0x80>;
	};

	i2c1@11008000 {
		aed = <0x1a>;
		clock-div = <0x5>;
		clock-names = "main", "dma";
		clocks = <0x1f 0xb 0x1f 0x26>;
		compatible = "mediatek,i2c";
		id = <0x1>;
		interrupts = <0x0 0x1d 0x8>;
		linux,phandle = <0x7b>;
		mediatek,hs_only;
		phandle = <0x7b>;
		reg = <0x0 0x11008000 0x0 0x1000 0x0 0x11000100 0x0 0x80>;
	};

	i2c2@11009000 {
		aed = <0x1a>;
		ch_offset_ccu = <0x200>;
		ch_offset_default = <0x100>;
		clock-div = <0x5>;
		clock-names = "main", "dma";
		clocks = <0x1f 0xb 0x1f 0x26>;
		compatible = "mediatek,i2c";
		id = <0x2>;
		interrupts = <0x0 0x1e 0x8>;
		linux,phandle = <0x7c>;
		mediatek,hs_only;
		phandle = <0x7c>;
		reg = <0x0 0x11009000 0x0 0x1000 0x0 0x11000180 0x0 0x180>;
	};

	i2c3@1100f000 {
		aed = <0x1a>;
		ch_offset_default = <0x100>;
		clock-div = <0x5>;
		clock-names = "main", "dma";
		clocks = <0x1f 0xb 0x1f 0x26>;
		compatible = "mediatek,i2c";
		id = <0x3>;
		interrupts = <0x0 0x1f 0x8>;
		linux,phandle = <0x7d>;
		mediatek,hs_only;
		phandle = <0x7d>;
		reg = <0x0 0x1100f000 0x0 0x1000 0x0 0x11000300 0x0 0x100>;
	};

	i2c4@11011000 {
		aed = <0x1a>;
		ch_offset_ccu = <0x200>;
		ch_offset_default = <0x100>;
		clock-div = <0x5>;
		clock-names = "main", "dma";
		clocks = <0x1f 0xb 0x1f 0x26>;
		compatible = "mediatek,i2c";
		id = <0x4>;
		interrupts = <0x0 0x20 0x8>;
		linux,phandle = <0x7e>;
		mediatek,hs_only;
		phandle = <0x7e>;
		reg = <0x0 0x11011000 0x0 0x1000 0x0 0x11000400 0x0 0x180>;
	};

	i2c5@11016000 {
		aed = <0x1a>;
		clock-div = <0x5>;
		clock-names = "main", "dma";
		clocks = <0x1f 0xb 0x1f 0x26>;
		compatible = "mediatek,i2c";
		id = <0x5>;
		interrupts = <0x0 0x4a 0x8>;
		linux,phandle = <0x7f>;
		mediatek,hs_only;
		phandle = <0x7f>;
		reg = <0x0 0x11016000 0x0 0x1000 0x0 0x11000580 0x0 0x80>;
	};

	i2c6@1100d000 {
		aed = <0x1a>;
		ch_offset_ccu = <0x200>;
		ch_offset_default = <0x100>;
		clock-div = <0x5>;
		clock-names = "main", "dma";
		clocks = <0x1f 0xb 0x1f 0x26>;
		compatible = "mediatek,i2c";
		id = <0x6>;
		interrupts = <0x0 0x4b 0x8>;
		linux,phandle = <0x80>;
		mediatek,hs_only;
		phandle = <0x80>;
		reg = <0x0 0x1100d000 0x0 0x1000 0x0 0x11000600 0x0 0x80>;
	};

	i2c7 {
		linux,phandle = <0x81>;
		phandle = <0x81>;
	};

	i2c8 {
		linux,phandle = <0x82>;
		phandle = <0x82>;
	};

	i2c9 {
		linux,phandle = <0x83>;
		phandle = <0x83>;
	};

	i2c_common {
		check_max_freq = [01];
		cnt_constraint = [01];
		compatible = "mediatek,i2c_common";
		dma_support = [02];
		ext_time_config = [18 01];
		idvfs = [01];
		linux,phandle = <0x79>;
		phandle = <0x79>;
		set_dt_div = [01];
		set_ltiming = [01];
		ver = [02];
	};

	imp_iic@11017000 {
		compatible = "mediatek,imp_iic";
		reg = <0x0 0x11017000 0x0 0x1000>;
	};

	infra_mbist@1020d000 {
		compatible = "mediatek,infra_mbist";
		reg = <0x0 0x1020d000 0x0 0x1000>;
	};

	infracfg@1020e000 {
		compatible = "mediatek,infracfg";
		reg = <0x0 0x1020e000 0x0 0x1000>;
	};

	infracfg_ao@10001000 {
		#clock-cells = <0x1>;
		compatible = "mediatek,infracfg_ao", "syscon";
		interrupts = <0x0 0x5b 0x1>;
		linux,phandle = <0x1f>;
		phandle = <0x1f>;
		reg = <0x0 0x10001000 0x0 0x1000>;
	};

	interrupt-controller@0c000000 {
		#address-cells = <0x2>;
		#interrupt-cells = <0x3>;
		#redistributor-regions = <0x1>;
		#size-cells = <0x2>;
		compatible = "arm,gic-v3";
		interrupt-controller;
		interrupt-parent = <0xd>;
		interrupts = <0x1 0x9 0x4>;
		linux,phandle = <0xd>;
		phandle = <0xd>;
		reg = <0x0 0xc000000 0x0 0x40000 0x0 0xc080000 0x0 0x200000 0x0 0x10200a80 0x0 0x50>;
	};

	intpol-controller@10200a80 {
		#interrupt-cells = <0x3>;
		compatible = "mediatek,mt6577-sysirq";
		interrupt-controller;
		interrupt-parent = <0xd>;
		linux,phandle = <0x1>;
		phandle = <0x1>;
		reg = <0x0 0x10200a80 0x0 0x50>;
	};

	io_cfg_bl@10002600 {
		compatible = "mediatek,io_cfg_bl";
		reg = <0x0 0x10002600 0x0 0x200>;
	};

	io_cfg_lb@10002400 {
		compatible = "mediatek,io_cfg_lb";
		reg = <0x0 0x10002400 0x0 0x200>;
	};

	io_cfg_lm@10002200 {
		compatible = "mediatek,io_cfg_lm";
		reg = <0x0 0x10002200 0x0 0x200>;
	};

	io_cfg_lt@10002000 {
		compatible = "mediatek,io_cfg_lt";
		reg = <0x0 0x10002000 0x0 0x200>;
	};

	io_cfg_rb@10002a00 {
		compatible = "mediatek,io_cfg_rb";
		reg = <0x0 0x10002a00 0x0 0x200>;
	};

	io_cfg_rr@10002800 {
		compatible = "mediatek,io_cfg_rr";
		reg = <0x0 0x10002800 0x0 0x200>;
	};

	io_cfg_rt@10002c00 {
		compatible = "mediatek,io_cfg_rt";
		reg = <0x0 0x10002c00 0x0 0x200>;
	};

	iocfg_0@10002000 {
		compatible = "mediatek,iocfg_0";
		reg = <0x0 0x10002000 0x0 0x200>;
	};

	iocfg_1@10002200 {
		compatible = "mediatek,iocfg_1";
		reg = <0x0 0x10002200 0x0 0x200>;
	};

	iocfg_2@10002400 {
		compatible = "mediatek,iocfg_2";
		reg = <0x0 0x10002400 0x0 0x200>;
	};

	iocfg_3@10002600 {
		compatible = "mediatek,iocfg_3";
		reg = <0x0 0x10002600 0x0 0x200>;
	};

	iocfg_4@10002800 {
		compatible = "mediatek,iocfg_4";
		reg = <0x0 0x10002800 0x0 0x200>;
	};

	iocfg_5@10002a00 {
		compatible = "mediatek,iocfg_5";
		reg = <0x0 0x10002a00 0x0 0x200>;
	};

	irq_nfc {
		compatible = "mediatek,irq_nfc-eint";
		linux,phandle = <0x92>;
		phandle = <0x92>;
	};

	ispsys@15000000 {
		clock-names = "CG_SCP_SYS_DIS", "CG_SCP_SYS_CAM", "CG_CAM_LARB2", "CG_CAM", "CG_CAMTG", "CG_CAM_SENINF", "CG_CAMSV0", "CG_CAMSV1", "CG_MM_SMI_COMM0", "CG_MM_SMI_COMM1", "CG_MM_SMI_COMMON";
		clocks = <0x20 0x3 0x20 0x8 0x3c 0x0 0x3c 0x1 0x3c 0x2 0x3c 0x3 0x3c 0x4 0x3c 0x5 0x21 0x15 0x21 0x16 0x21 0x13>;
		compatible = "mediatek,mt6761-ispsys";
		interrupts = <0x0 0xb3 0x8 0x0 0xb4 0x8 0x0 0xb5 0x8 0x0 0xb8 0x8 0x0 0xb9 0x8 0x0 0xba 0x8 0x0 0xbb 0x8>;
		reg = <0x0 0x15004000 0x0 0x9000 0x0 0x1500d000 0x0 0x1000 0x0 0x15000000 0x0 0x52000 0x0 0x15040000 0x0 0x8000 0x0 0x10215000 0x0 0x3000 0x0 0x10211000 0x0 0x1000>;
	};

	kd_camera_hw1@15040000 {
		clock-names = "CLK_TOP_CAMTG_SEL", "CLK_TOP_CAMTG1_SEL", "CLK_TOP_CAMTG2_SEL", "CLK_TOP_CAMTG3_SEL", "CLK_MCLK_6M", "CLK_MCLK_12M", "CLK_MCLK_13M", "CLK_MCLK_48M", "CLK_MCLK_52M", "CLK_MCLK_24M", "CLK_MCLK_26M", "CLK_CAM_SENINF_CG", "CLK_MIPI_C0_26M_CG", "CLK_MIPI_C1_26M_CG", "CLK_MIPI_ANA_0A_CG", "CLK_MIPI_ANA_0B_CG", "CLK_MIPI_ANA_1A_CG", "CLK_MIPI_ANA_1B_CG", "CLK_MIPI_ANA_2A_CG", "CLK_MIPI_ANA_2B_CG", "CLK_TOP_CAMTM_SEL_CG", "CLK_TOP_CAMTM_208_CG", "CLK_SCP_SYS_CAM";
		clocks = <0x19 0x6f 0x19 0x70 0x19 0x71 0x19 0x72 0x19 0x16 0x19 0x15 0x19 0x20 0x19 0x13 0x19 0x1f 0x19 0x14 0x1b 0x3c 0x3 0x3b 0xc 0x3b 0x10 0x3d 0x0 0x3e 0x0 0x3f 0x0 0x40 0x0 0x41 0x0 0x42 0x0 0x19 0x86 0x19 0x1d 0x20 0x8>;
		compatible = "mediatek,camera_hw";
		linux,phandle = <0x96>;
		phandle = <0x96>;
		reg = <0x0 0x15040000 0x0 0x1000>;
	};

	kp@10010000 {
		compatible = "mediatek,kp";
		interrupts = <0x0 0x7c 0x2>;
		linux,phandle = <0xe>;
		phandle = <0xe>;
		reg = <0x0 0x10010000 0x0 0x1000>;
	};

	l2c_parity {
		compatible = "mediatek,l2c_parity-v1";
		interrupts = <0x0 0x0 0x4>;
	};

	lk_charger {
		ac_charger_current = <0x16e360>;
		ac_charger_input_current = <0x16e360>;
		charging_host_charger_current = <0xf4240>;
		compatible = "mediatek,lk_charger";
		enable_anime;
		fast_charge_voltage = <0x2625a0>;
		linux,phandle = <0x9f>;
		max_charger_voltage = <0x632ea0>;
		non_std_ac_charger_current = <0x7a120>;
		pd_charger_current = <0x7a120>;
		phandle = <0x9f>;
		power_path_support;
		ta_ac_charger_current = <0x2dc6c0>;
		temp_t1_threshold = <0x0>;
		temp_t3_threshold = <0x2d>;
		temp_t4_threshold = <0x32>;
		usb_charger_current = <0x7a120>;
	};

	m4u@10205000 {
		#iommu-cells = <0x1>;
		cell-index = <0x0>;
		compatible = "mediatek,iommu_v0";
		interrupts = <0x0 0x9e 0x8>;
		linux,phandle = <0x44>;
		mediatek,larbs = <0x1c 0x1d 0x1e>;
		phandle = <0x44>;
		reg = <0x0 0x10205000 0x0 0x1000>;
	};

	mbist@17050000 {
		compatible = "mediatek,mbist";
		reg = <0x0 0x17050000 0x0 0x10000>;
	};

	mbist_ao@10013000 {
		compatible = "mediatek,mbist_ao";
		reg = <0x0 0x10013000 0x0 0x1000>;
	};

	mcdi@0010fc00 {
		compatible = "mediatek,mt6761-mcdi";
		reg = <0x0 0x10fc00 0x0 0x800>;
	};

	mcucfg@10200000 {
		compatible = "mediatek,mcucfg";
		interrupts = <0x0 0x0 0x4>;
		reg = <0x0 0x10200000 0x0 0x200>;
	};

	mcucfg@10200200 {
		compatible = "mediatek,mcucfg";
		interrupts = <0x0 0x1 0x8>;
		reg = <0x0 0x10200200 0x0 0x200>;
	};

	mcucfg@10200400 {
		compatible = "mediatek,mcucfg";
		interrupts = <0x0 0x2 0x4>;
		reg = <0x0 0x10200400 0x0 0x200>;
	};

	mcucfg@10200600 {
		compatible = "mediatek,mcucfg";
		interrupts = <0x0 0x3 0x4>;
		reg = <0x0 0x10200600 0x0 0x200>;
	};

	mcucfg@10200800 {
		compatible = "mediatek,mcucfg";
		interrupts = <0x0 0x4 0x4>;
		reg = <0x0 0x10200800 0x0 0x200>;
	};

	mcucfg@10200a00 {
		compatible = "mediatek,mcucfg";
		interrupts = <0x0 0x5 0x8>;
		reg = <0x0 0x10200a00 0x0 0x300>;
	};

	mcucfg@10200f00 {
		compatible = "mediatek,mcucfg";
		interrupts = <0x0 0x6 0x8>;
		reg = <0x0 0x10200f00 0x0 0x100>;
	};

	mcucfg@10201000 {
		compatible = "mediatek,mcucfg";
		interrupts = <0x0 0x7 0x8>;
		reg = <0x0 0x10201000 0x0 0x1000>;
	};

	mcucfg@10202000 {
		compatible = "mediatek,mcucfg";
		interrupts = <0x0 0x8 0x8>;
		reg = <0x0 0x10202000 0x0 0x1000>;
	};

	mcucfg@10203000 {
		compatible = "mediatek,mcucfg";
		interrupts = <0x0 0x9 0x8>;
		reg = <0x0 0x10203000 0x0 0x1000>;
	};

	mcucfg_mp0_counter@10200000 {
		compatible = "mediatek,mcucfg_mp0_counter";
		reg = <0x0 0x10200000 0x0 0x4000>;
	};

	mcupm_reg@10216000 {
		compatible = "mediatek,mcupm_reg";
		reg = <0x0 0x10216000 0x0 0x1000>;
	};

	mcupm_sram0@10217000 {
		compatible = "mediatek,mcupm_sram0";
		reg = <0x0 0x10217000 0x0 0x1000>;
	};

	mcupm_sram1@10218000 {
		compatible = "mediatek,mcupm_sram1";
		reg = <0x0 0x10218000 0x0 0x1000>;
	};

	mcupm_sram2@10211000 {
		compatible = "mediatek,mcupm_sram2";
		reg = <0x0 0x10211000 0x0 0x1000>;
	};

	mcupm_sram3@10213000 {
		compatible = "mediatek,mcupm_sram3";
		reg = <0x0 0x10213000 0x0 0x1000>;
	};

	md1_sim1_hot_plug_eint {
		linux,phandle = <0x4a>;
		phandle = <0x4a>;
	};

	md1_sim2_hot_plug_eint {
		linux,phandle = <0x4b>;
		phandle = <0x4b>;
	};

	md_ccif0@1020a000 {
		compatible = "mediatek,md_ccif0";
		reg = <0x0 0x1020a000 0x0 0x1000>;
	};

	md_ccif1@1020c000 {
		compatible = "mediatek,md_ccif1";
		reg = <0x0 0x1020c000 0x0 0x1000>;
	};

	md_ccif2@1023d000 {
		compatible = "mediatek,md_ccif2";
		reg = <0x0 0x1023d000 0x0 0x1000>;
	};

	md_ccif3@1023f000 {
		compatible = "mediatek,md_ccif3";
		reg = <0x0 0x1023f000 0x0 0x1000>;
	};

	mdcldma@10014000 {
		clock-names = "scp-sys-md1-main", "infra-cldma-bclk", "infra-ccif-ap", "infra-ccif-md", "infra-ccif1-ap", "infra-ccif1-md", "infra-ccif2-ap", "infra-ccif2-md";
		clocks = <0x20 0x0 0x1f 0x32 0x1f 0x29 0x1f 0x2c 0x1f 0x23 0x1f 0x24 0x1f 0x58 0x1f 0x59>;
		compatible = "mediatek,mdcldma";
		interrupts = <0x0 0x6d 0x4 0x0 0x5c 0x8 0x0 0x5d 0x8 0x0 0xcd 0x2>;
		linux,phandle = <0x10>;
		mediatek,cldma_capability = <0x6>;
		mediatek,md_id = <0x0>;
		phandle = <0x10>;
		reg = <0x0 0x10014000 0x0 0x1000 0x0 0x1021b000 0x0 0x1000 0x0 0x10209000 0x0 0x1000 0x0 0x1020a000 0x0 0x1000>;
	};

	mdcldmain@1021c000 {
		compatible = "mediatek,mdcldmain";
		reg = <0x0 0x1021c000 0x0 0x400>;
	};

	mdcldmain_ao@10015000 {
		compatible = "mediatek,mdcldmain_ao";
		reg = <0x0 0x10015000 0x0 0x400>;
	};

	mdcldmamisc@1021c800 {
		compatible = "mediatek,mdcldmamisc";
		reg = <0x0 0x1021c800 0x0 0x1000>;
	};

	mdcldmamisc_ao@10015800 {
		compatible = "mediatek,mdcldmamisc_ao";
		reg = <0x0 0x10015800 0x0 0x400>;
	};

	mdcldmaout@1021c400 {
		compatible = "mediatek,mdcldmaout";
		reg = <0x0 0x1021c400 0x0 0x400>;
	};

	mdcldmaout_ao@10015400 {
		compatible = "mediatek,mdcldmaout_ao";
		reg = <0x0 0x10015400 0x0 0x400>;
	};

	mdp_ccorr0@14005000 {
		clock-names = "MDP_CCORR";
		clocks = <0x21 0x1>;
		compatible = "mediatek,mdp_ccorr0";
		interrupts = <0x0 0xaa 0x8>;
		linux,phandle = <0x29>;
		phandle = <0x29>;
		reg = <0x0 0x14005000 0x0 0x1000>;
	};

	mdp_rdma0@14004000 {
		clock-names = "MDP_RDMA0";
		clocks = <0x21 0x0>;
		compatible = "mediatek,mdp_rdma0";
		interrupts = <0x0 0x9b 0x8>;
		linux,phandle = <0x22>;
		phandle = <0x22>;
		reg = <0x0 0x14004000 0x0 0x1000>;
	};

	mdp_rsz0@14006000 {
		clock-names = "MDP_RSZ0";
		clocks = <0x21 0x2>;
		compatible = "mediatek,mdp_rsz0";
		interrupts = <0x0 0x9c 0x8>;
		linux,phandle = <0x23>;
		phandle = <0x23>;
		reg = <0x0 0x14006000 0x0 0x1000>;
	};

	mdp_rsz1@14007000 {
		clock-names = "MDP_RSZ1";
		clocks = <0x21 0x3>;
		compatible = "mediatek,mdp_rsz1";
		interrupts = <0x0 0x9d 0x8>;
		linux,phandle = <0x24>;
		phandle = <0x24>;
		reg = <0x0 0x14007000 0x0 0x1000>;
	};

	mdp_tdshp0@1400a000 {
		clock-names = "MDP_TDSHP";
		clocks = <0x21 0x4>;
		compatible = "mediatek,mdp_tdshp0";
		linux,phandle = <0x27>;
		phandle = <0x27>;
		reg = <0x0 0x1400a000 0x0 0x1000>;
	};

	mdp_wdma0@14008000 {
		clock-names = "MDP_WDMA";
		clocks = <0x21 0x6>;
		compatible = "mediatek,mdp_wdma0";
		interrupts = <0x0 0xa0 0x8>;
		linux,phandle = <0x25>;
		phandle = <0x25>;
		reg = <0x0 0x14008000 0x0 0x1000>;
	};

	mdp_wrot0@14009000 {
		clock-names = "MDP_WROT0";
		clocks = <0x21 0x5>;
		compatible = "mediatek,mdp_wrot0";
		interrupts = <0x0 0x9f 0x8>;
		linux,phandle = <0x26>;
		phandle = <0x26>;
		reg = <0x0 0x14009000 0x0 0x1000>;
	};

	memory {
		device_type = "memory";
		reg = <0x0 0x40000000 0x0 0x20000000>;
	};

	mfg_cfg@13ffe000 {
		#clock-cells = <0x1>;
		compatible = "mediatek,mfgcfg", "syscon";
		linux,phandle = <0x90>;
		phandle = <0x90>;
		reg = <0x0 0x13ffe000 0x0 0x1000>;
	};

	mfg_clark@13000000 {
		clock-frequency = <0x21f98280>;
		compatible = "mediatek,clark";
		interrupt-names = "RGX";
		interrupts = <0x0 0xcb 0x8>;
		reg = <0x0 0x13000000 0x0 0x80000>;
	};

	mipi_rx_ana_csi0a@11c10000 {
		#clock-cells = <0x1>;
		compatible = "mediatek,mipi_rx_ana_csi0a", "syscon";
		linux,phandle = <0x3d>;
		phandle = <0x3d>;
		reg = <0x0 0x11c10000 0x0 0x1000>;
	};

	mipi_rx_ana_csi0b@11c11000 {
		#clock-cells = <0x1>;
		compatible = "mediatek,mipi_rx_ana_csi0b", "syscon";
		linux,phandle = <0x3e>;
		phandle = <0x3e>;
		reg = <0x0 0x11c11000 0x0 0x1000>;
	};

	mipi_rx_ana_csi1@11c20000 {
		compatible = "mediatek,mipi_rx_ana_csi1";
		reg = <0x0 0x11c20000 0x0 0x10000>;
	};

	mipi_rx_ana_csi1a@11c12000 {
		#clock-cells = <0x1>;
		compatible = "mediatek,mipi_rx_ana_csi1a", "syscon";
		linux,phandle = <0x3f>;
		phandle = <0x3f>;
		reg = <0x0 0x11c12000 0x0 0x1000>;
	};

	mipi_rx_ana_csi1b@11c13000 {
		#clock-cells = <0x1>;
		compatible = "mediatek,mipi_rx_ana_csi1b", "syscon";
		linux,phandle = <0x40>;
		phandle = <0x40>;
		reg = <0x0 0x11c13000 0x0 0x1000>;
	};

	mipi_rx_ana_csi2@11c30000 {
		compatible = "mediatek,mipi_rx_ana_csi2";
		reg = <0x0 0x11c30000 0x0 0x10000>;
	};

	mipi_rx_ana_csi2a@11c14000 {
		#clock-cells = <0x1>;
		compatible = "mediatek,mipi_rx_ana_csi2a", "syscon";
		linux,phandle = <0x41>;
		phandle = <0x41>;
		reg = <0x0 0x11c14000 0x0 0x1000>;
	};

	mipi_rx_ana_csi2b@11c15000 {
		#clock-cells = <0x1>;
		compatible = "mediatek,mipi_rx_ana_csi2b", "syscon";
		linux,phandle = <0x42>;
		phandle = <0x42>;
		reg = <0x0 0x11c15000 0x0 0x1000>;
	};

	mipi_tx0@11c80000 {
		compatible = "mediatek,mipi_tx0";
		reg = <0x0 0x11c80000 0x0 0x10000>;
	};

	mm_mutex@14016000 {
		compatible = "mediatek,mm_mutex";
		linux,phandle = <0x95>;
		phandle = <0x95>;
		reg = <0x0 0x14016000 0x0 0x1000>;
	};

	mmdvfs_pmqos {
		cam_freq = "mm_step0", "mm_step1", "mm_step2";
		clock-names = "mmdvfs_clk_mm_sel_ck", "mmdvfs_clk_mmpll_ck", "mmdvfs_clk_univpll1_d2_ck", "mmdvfs_clk_mmpll_d2_ck";
		clocks = <0x19 0x6b 0x19 0x24 0x19 0x1a 0x19 0x25>;
		compatible = "mediatek,mmdvfs_pmqos";
		disp_freq = "mm_step0", "mm_step1", "mm_step2";
		img_freq = "mm_step0", "mm_step1", "mm_step2";
		mdp_freq = "mm_step0", "mm_step1", "mm_step2";
		mm_step0 = <0x1b4 0x1 0x0 0x1>;
		mm_step0_ext = <0x1b4 0x2 0x6 0x10c4ec>;
		mm_step1 = <0x138 0x1 0x0 0x2>;
		mm_step1_ext = <0x138 0x2 0x6 0x10c4ec>;
		mm_step2 = <0xe3 0x1 0x0 0x3>;
		mm_step2_ext = <0xe3 0x2 0x6 0x117627>;
		vdec_freq = "mm_step0", "mm_step1", "mm_step2";
		venc_freq = "mm_step0", "mm_step1", "mm_step2";
		vopp_steps = <0x0 0x1 0x3>;
	};

	mmsys_config@14000000 {
		#clock-cells = <0x1>;
		clock-names = "CAM_MDP", "IMG_DL_RELAY", "IMG_DL_ASYNC_TOP";
		clocks = <0x21 0x17 0x21 0x1a 0x21 0x1b>;
		compatible = "mediatek,mmsys_config", "syscon";
		interrupts = <0x0 0xab 0x8>;
		linux,phandle = <0x21>;
		phandle = <0x21>;
		reg = <0x0 0x14000000 0x0 0x1000>;
	};

	mobicore {
		compatible = "trustonic,mobicore";
		interrupts = <0x0 0xc2 0x1>;
	};

	modem_temp_share@10018000 {
		compatible = "mediatek,modem_temp_share";
		reg = <0x0 0x10018000 0x0 0x1000>;
	};

	mrdump_ext_rst {
		compatible = "mediatek, mrdump_ext_rst-eint";
		linux,phandle = <0x70>;
		mode = "IRQ";
		phandle = <0x70>;
		source = "EINT";
		status = "okay";
	};

	msdc0_pad_macro@11cd0000 {
		compatible = "mediatek,msdc0_pad_macro";
		reg = <0x0 0x11cd0000 0x0 0x10000>;
	};

	msdc0_top@11cd0000 {
		compatible = "mediatek,msdc0_top";
		reg = <0x0 0x11cd0000 0x0 0x1000>;
	};

	msdc1_ins@0 {
		compatible = "mediatek,mt6761-sdcard-ins";
		linux,phandle = <0x8e>;
		phandle = <0x8e>;
	};

	msdc1_pad_macro@11c90000 {
		compatible = "mediatek,msdc1_pad_macro";
		reg = <0x0 0x11c90000 0x0 0x10000>;
	};

	msdc1_top@11c90000 {
		compatible = "mediatek,msdc1_top";
		reg = <0x0 0x11c90000 0x0 0x1000>;
	};

	msdc@11230000 {
		bootable;
		bus-width = <0x8>;
		cap-mmc-highspeed;
		clk_src = [01];
		clock-names = "msdc0-clock", "msdc0-hclock", "msdc0-aes-clock";
		clocks = <0x1f 0x4f 0x1f 0x1c 0x1f 0x45>;
		compatible = "mediatek,msdc";
		host_function = [00];
		index = [00];
		interrupts = <0x0 0x17 0x8>;
		linux,phandle = <0x8a>;
		max-frequency = <0xbebc200>;
		mmc-ddr-1_8v;
		mmc-hs200-1_8v;
		mmc-hs400-1_8v;
		no-sd;
		no-sdio;
		non-removable;
		phandle = <0x8a>;
		pinctl = <0x2d>;
		pinctl_hs200 = <0x2f>;
		pinctl_hs400 = <0x2e>;
		reg = <0x0 0x11230000 0x0 0x10000>;
		register_setting = <0x30>;
		status = "okay";
		vmmc-supply = <0x31>;
	};

	msdc@11240000 {
		bus-width = <0x4>;
		cap-sd-highspeed;
		cd-gpios = <0x37 0x0 0x0>;
		cd_level = [01];
		clk_src = [02];
		clock-names = "msdc1-clock", "msdc1-hclock";
		clocks = <0x1f 0x50 0x1f 0x1d>;
		compatible = "mediatek,msdc";
		host_function = [01];
		index = [01];
		interrupts = <0x0 0x18 0x8>;
		linux,phandle = <0x8b>;
		max-frequency = <0xbebc200>;
		no-mmc;
		no-sdio;
		phandle = <0x8b>;
		pinctl = <0x32>;
		pinctl_ddr50 = <0x35>;
		pinctl_sdr104 = <0x33>;
		pinctl_sdr50 = <0x34>;
		reg = <0x0 0x11240000 0x0 0x10000>;
		register_setting = <0x36>;
		sd-uhs-ddr50;
		sd-uhs-sdr104;
		sd-uhs-sdr12;
		sd-uhs-sdr25;
		sd-uhs-sdr50;
		status = "okay";
		vmmc-supply = <0x38>;
		vqmmc-supply = <0x39>;
	};

	msdc@11250000 {
		compatible = "mediatek,msdc2";
		linux,phandle = <0x8c>;
		phandle = <0x8c>;
		reg = <0x0 0x11250000 0x0 0x10000>;
		status = "disable";
	};

	msdc@11260000 {
		compatible = "mediatek,msdc3";
		linux,phandle = <0x8d>;
		phandle = <0x8d>;
		reg = <0x0 0x11250000 0x0 0x10000>;
		status = "disable";
	};

	mt-pmic {
		compatible = "mediatek,mt_pmic";
		interrupt-controller;
		linux,phandle = <0x51>;
		phandle = <0x51>;

		buck_regulators {

			buck_vcore {
				linux,phandle = <0x55>;
				phandle = <0x55>;
				regulator-enable-ramp-delay = <0xdc>;
				regulator-max-microvolt = <0x1406f4>;
				regulator-min-microvolt = <0x7ea5e>;
				regulator-name = "vcore";
				regulator-ramp-delay = <0x186a>;
			};

			buck_vmodem {
				linux,phandle = <0x54>;
				phandle = <0x54>;
				regulator-enable-ramp-delay = <0xdc>;
				regulator-max-microvolt = <0x123716>;
				regulator-min-microvolt = <0x7a120>;
				regulator-name = "vmodem";
				regulator-ramp-delay = <0x186a>;
			};

			buck_vpa {
				linux,phandle = <0x57>;
				phandle = <0x57>;
				regulator-enable-ramp-delay = <0xdc>;
				regulator-max-microvolt = <0x37b1d0>;
				regulator-min-microvolt = <0x7a120>;
				regulator-name = "vpa";
				regulator-ramp-delay = <0xc350>;
			};

			buck_vproc {
				linux,phandle = <0x56>;
				phandle = <0x56>;
				regulator-enable-ramp-delay = <0xdc>;
				regulator-max-microvolt = <0x1406f4>;
				regulator-min-microvolt = <0x7ea5e>;
				regulator-name = "vproc";
				regulator-ramp-delay = <0x186a>;
			};

			buck_vs1 {
				linux,phandle = <0x53>;
				phandle = <0x53>;
				regulator-enable-ramp-delay = <0xdc>;
				regulator-max-microvolt = <0x2191c0>;
				regulator-min-microvolt = <0x124f80>;
				regulator-name = "vs1";
				regulator-ramp-delay = <0x30d4>;
			};
		};

		ldo_regulators {

			ldo_vaud28 {
				compatible = "regulator-fixed";
				linux,phandle = <0x68>;
				phandle = <0x68>;
				regulator-enable-ramp-delay = <0x108>;
				regulator-max-microvolt = <0x2ab980>;
				regulator-min-microvolt = <0x2ab980>;
				regulator-name = "vaud28";
			};

			ldo_vaux18 {
				compatible = "regulator-fixed";
				linux,phandle = <0x67>;
				phandle = <0x67>;
				regulator-enable-ramp-delay = <0x108>;
				regulator-max-microvolt = <0x1b7740>;
				regulator-min-microvolt = <0x1b7740>;
				regulator-name = "vaux18";
			};

			ldo_vcama {
				linux,phandle = <0x61>;
				phandle = <0x61>;
				regulator-enable-ramp-delay = <0x108>;
				regulator-max-microvolt = <0x2ab980>;
				regulator-min-microvolt = <0x2625a0>;
				regulator-name = "vcama";
			};

			ldo_vcamd {
				linux,phandle = <0x62>;
				phandle = <0x62>;
				regulator-enable-ramp-delay = <0x108>;
				regulator-max-microvolt = <0x1b7740>;
				regulator-min-microvolt = <0xf4240>;
				regulator-name = "vcamd";
			};

			ldo_vcamio {
				compatible = "regulator-fixed";
				linux,phandle = <0x63>;
				phandle = <0x63>;
				regulator-enable-ramp-delay = <0x108>;
				regulator-max-microvolt = <0x1b7740>;
				regulator-min-microvolt = <0x1b7740>;
				regulator-name = "vcamio";
			};

			ldo_vcn18 {
				compatible = "regulator-fixed";
				linux,phandle = <0x60>;
				phandle = <0x60>;
				regulator-enable-ramp-delay = <0x108>;
				regulator-max-microvolt = <0x1b7740>;
				regulator-min-microvolt = <0x1b7740>;
				regulator-name = "vcn18";
			};

			ldo_vcn28 {
				compatible = "regulator-fixed";
				linux,phandle = <0x5f>;
				phandle = <0x5f>;
				regulator-enable-ramp-delay = <0x108>;
				regulator-max-microvolt = <0x2ab980>;
				regulator-min-microvolt = <0x2ab980>;
				regulator-name = "vcn28";
			};

			ldo_vcn33_bt {
				linux,phandle = <0x5d>;
				phandle = <0x5d>;
				regulator-enable-ramp-delay = <0x108>;
				regulator-max-microvolt = <0x3567e0>;
				regulator-min-microvolt = <0x325aa0>;
				regulator-name = "vcn33_bt";
			};

			ldo_vcn33_wifi {
				linux,phandle = <0x5e>;
				phandle = <0x5e>;
				regulator-enable-ramp-delay = <0x108>;
				regulator-max-microvolt = <0x3567e0>;
				regulator-min-microvolt = <0x325aa0>;
				regulator-name = "vcn33_wifi";
			};

			ldo_vdram {
				linux,phandle = <0x6b>;
				phandle = <0x6b>;
				regulator-enable-ramp-delay = <0xce4>;
				regulator-max-microvolt = <0x124f80>;
				regulator-min-microvolt = <0x10c8e0>;
				regulator-name = "vdram";
			};

			ldo_vefuse {
				linux,phandle = <0x5c>;
				phandle = <0x5c>;
				regulator-enable-ramp-delay = <0x108>;
				regulator-max-microvolt = <0x325aa0>;
				regulator-min-microvolt = <0x124f80>;
				regulator-name = "vefuse";
			};

			ldo_vemc {
				linux,phandle = <0x31>;
				phandle = <0x31>;
				regulator-enable-ramp-delay = <0x2c>;
				regulator-max-microvolt = <0x325aa0>;
				regulator-min-microvolt = <0x2c4020>;
				regulator-name = "vemc";
			};

			ldo_vfe28 {
				compatible = "regulator-fixed";
				linux,phandle = <0x58>;
				phandle = <0x58>;
				regulator-enable-ramp-delay = <0x108>;
				regulator-max-microvolt = <0x2ab980>;
				regulator-min-microvolt = <0x2ab980>;
				regulator-name = "vfe28";
			};

			ldo_vibr {
				linux,phandle = <0x6e>;
				phandle = <0x6e>;
				regulator-enable-ramp-delay = <0x2c>;
				regulator-max-microvolt = <0x325aa0>;
				regulator-min-microvolt = <0x124f80>;
				regulator-name = "vibr";
			};

			ldo_vio18 {
				compatible = "regulator-fixed";
				linux,phandle = <0x6a>;
				phandle = <0x6a>;
				regulator-enable-ramp-delay = <0x108>;
				regulator-max-microvolt = <0x1b7740>;
				regulator-min-microvolt = <0x1b7740>;
				regulator-name = "vio18";
			};

			ldo_vio28 {
				compatible = "regulator-fixed";
				linux,phandle = <0x69>;
				phandle = <0x69>;
				regulator-enable-ramp-delay = <0x108>;
				regulator-max-microvolt = <0x2ab980>;
				regulator-min-microvolt = <0x2ab980>;
				regulator-name = "vio28";
			};

			ldo_vldo28 {
				linux,phandle = <0x64>;
				phandle = <0x64>;
				regulator-enable-ramp-delay = <0x108>;
				regulator-max-microvolt = <0x2dc6c0>;
				regulator-min-microvolt = <0x2ab980>;
				regulator-name = "vldo28";
			};

			ldo_vmc {
				linux,phandle = <0x39>;
				phandle = <0x39>;
				regulator-enable-ramp-delay = <0x2c>;
				regulator-max-microvolt = <0x325aa0>;
				regulator-min-microvolt = <0x1b7740>;
				regulator-name = "vmc";
			};

			ldo_vmch {
				linux,phandle = <0x38>;
				phandle = <0x38>;
				regulator-enable-ramp-delay = <0x2c>;
				regulator-max-microvolt = <0x325aa0>;
				regulator-min-microvolt = <0x2c4020>;
				regulator-name = "vmch";
			};

			ldo_vrf12 {
				compatible = "regulator-fixed";
				linux,phandle = <0x5b>;
				phandle = <0x5b>;
				regulator-enable-ramp-delay = <0x6e>;
				regulator-max-microvolt = <0x124f80>;
				regulator-min-microvolt = <0x124f80>;
				regulator-name = "vrf12";
			};

			ldo_vrf18 {
				compatible = "regulator-fixed";
				linux,phandle = <0x5a>;
				phandle = <0x5a>;
				regulator-enable-ramp-delay = <0x6e>;
				regulator-max-microvolt = <0x1b7740>;
				regulator-min-microvolt = <0x1b7740>;
				regulator-name = "vrf18";
			};

			ldo_vsim1 {
				linux,phandle = <0x6c>;
				phandle = <0x6c>;
				regulator-enable-ramp-delay = <0x108>;
				regulator-max-microvolt = <0x2f4d60>;
				regulator-min-microvolt = <0x19f0a0>;
				regulator-name = "vsim1";
			};

			ldo_vsim2 {
				linux,phandle = <0x6d>;
				phandle = <0x6d>;
				regulator-enable-ramp-delay = <0x108>;
				regulator-max-microvolt = <0x2f4d60>;
				regulator-min-microvolt = <0x19f0a0>;
				regulator-name = "vsim2";
			};

			ldo_vsram_others {
				linux,phandle = <0x65>;
				phandle = <0x65>;
				regulator-enable-ramp-delay = <0x6e>;
				regulator-max-microvolt = <0x1406f4>;
				regulator-min-microvolt = <0x7ea5e>;
				regulator-name = "vsram_others";
				regulator-ramp-delay = <0x186a>;
			};

			ldo_vsram_proc {
				linux,phandle = <0x66>;
				phandle = <0x66>;
				regulator-enable-ramp-delay = <0x6e>;
				regulator-max-microvolt = <0x1406f4>;
				regulator-min-microvolt = <0x7ea5e>;
				regulator-name = "vsram_proc";
				regulator-ramp-delay = <0x186a>;
			};

			ldo_vusb33 {
				linux,phandle = <0x6f>;
				phandle = <0x6f>;
				regulator-enable-ramp-delay = <0x108>;
				regulator-max-microvolt = <0x2f4d60>;
				regulator-min-microvolt = <0x2dc6c0>;
				regulator-name = "vusb33";
			};

			ldo_vxo22 {
				linux,phandle = <0x59>;
				phandle = <0x59>;
				regulator-enable-ramp-delay = <0x6e>;
				regulator-max-microvolt = <0x249f00>;
				regulator-min-microvolt = <0x2191c0>;
				regulator-name = "vxo22";
			};
		};

		mt635x-auxadc {
			#io-channel-cells = <0x1>;
			compatible = "mediatek,mt635x-auxadc";
			linux,phandle = <0x52>;
			phandle = <0x52>;

			accdet {
				channel = <0x9>;
			};

			bat_temp {
				channel = <0x3>;
				resistance-ratio = <0x1 0x1>;
			};

			batadc {
				avg-num = <0x80>;
				channel = <0x0>;
				resistance-ratio = <0x3 0x1>;
			};

			chip_temp {
				channel = <0x5>;
			};

			dcxo_temp {
				avg-num = <0x10>;
				channel = <0xd>;
			};

			hpofs_cal {
				avg-num = <0x100>;
				channel = <0xc>;
			};

			isense {
				avg-num = <0x80>;
				channel = <0x1>;
				resistance-ratio = <0x3 0x1>;
			};

			tsx_temp {
				avg-num = <0x80>;
				channel = <0xb>;
			};

			vbif {
				channel = <0xe>;
				resistance-ratio = <0x1 0x1>;
			};

			vcdt {
				channel = <0x2>;
			};

			vcore_temp {
				channel = <0x6>;
			};

			vproc_temp {
				channel = <0x7>;
			};
		};
	};

	mt6357_gauge {
		alias_name = "mt6357";
		compatible = "mediatek,mt6357_gauge";
		gauge_name = "gauge";
	};

	mt6370_pmu_dts {
		#interrupt-cells = <0x1>;
		interrupt-controller;
		linux,phandle = <0xa4>;
		mt6370,intr_gpio = <0x37 0x3 0x0>;
		mt6370,intr_gpio_num = <0x3>;
		phandle = <0xa4>;

		bled {
			compatible = "mediatek,mt6370_pmu_bled";
			interrupt-names = "bled_ocp";
			mt,bl_ocp_level = <0x2>;
			mt,bl_ovp_level = <0x3>;
			mt,bled_flash_ramp = <0x1>;
			mt,bled_name = "mt6370_pmu_bled";
			mt,bled_ramptime = <0x3>;
			mt,chan_en = <0xf>;
			mt,map_linear;
			mt,max_bled_brightness = <0x200>;
			mt,pwm_avg_cycle = <0x0>;
			mt,pwm_deglitch = <0x1>;
			mt,pwm_fsample = <0x2>;
			mt,use_pwm;
		};

		charger {
			aicr = <0x7a120>;
			charger_name = "primary_chg";
			compatible = "mediatek,mt6370_pmu_charger";
			cv = <0x426030>;
			dc_wdt = <0x3d0900>;
			enable_te;
			enable_wdt;
			ichg = <0x1e8480>;
			ieoc = <0x249f0>;
			interrupt-names = "chg_mivr", "chg_aiclmeasi", "attachi", "ovpctrl_uvp_d_evt", "chg_wdtmri", "chg_vbusov", "chg_tmri", "chg_treg";
			ircmp_resistor = <0x61a8>;
			ircmp_vclamp = <0x7d00>;
			load_switch_name = "primary_load_switch";
			mivr = <0x432380>;
			safety_timer = <0xc>;
		};

		core {
			compatible = "mediatek,mt6370_pmu_core";
			i2cstmr_rst_tmr = <0x0>;
			int_deg = <0x0>;
			int_wdt = <0x0>;
			interrupt-names = "otp", "vdda_ovp", "vdda_uv";
			mrstb_en;
			mrstb_tmr = <0x3>;
		};

		dsv {
			compatible = "mediatek,mt6370_pmu_dsv";
			db_delay = <0x3>;
			db_ext_en = <0x0>;
			db_freq_pm = <0x0>;
			db_periodic_fix = <0x0>;
			db_periodic_mode = <0x0>;
			db_single_pin = <0x0>;
			db_startup = <0x0>;
			db_vbst = <0x1644>;
			db_vneg_20ms = <0x1>;
			db_vneg_disc = <0x0>;
			db_vneg_slew = <0x1>;
			db_vpos_20ms = <0x1>;
			db_vpos_disc = <0x0>;
			db_vpos_slew = <0x1>;
			interrupt-names = "dsv_vneg_ocp", "dsv_vpos_ocp", "dsv_bst_ocp", "dsv_vneg_scp", "dsv_vpos_scp";

			mt6370_dsvn {
				regulator-max-microvolt = <0x5b8d80>;
				regulator-min-microvolt = <0x3d0900>;
				regulator-name = "dsv_neg";
			};

			mt6370_dsvp {
				regulator-max-microvolt = <0x5b8d80>;
				regulator-min-microvolt = <0x3d0900>;
				regulator-name = "dsv_pos";
			};
		};

		ldo {
			compatible = "mediatek,mt6370_pmu_ldo";
			interrupt-names = "ldo_oc";
			ldo_oms = <0x1>;
			ldo_vrc_lt = <0x1>;

			mt6370_ldo {
				regulator-max-microvolt = <0x3d0900>;
				regulator-min-microvolt = <0x186a00>;
				regulator-name = "irtx_ldo";
			};
		};

		mt6370_pmu_fled1 {
			compatible = "mediatek,mt6370_pmu_fled1";
			fled_enable = <0x1>;
			interrupt-names = "fled_lvf", "fled2_short", "fled1_short";
			strobe_cur = <0x124f80>;
			strobe_timeout = <0x960>;
			torch_cur = <0x493e0>;
		};

		mt6370_pmu_fled2 {
			compatible = "mediatek,mt6370_pmu_fled2";
			fled_enable = <0x1>;
			strobe_cur = <0xf4240>;
			strobe_timeout = <0x4b0>;
			torch_cur = <0x30d40>;
		};

		rgbled {
			compatible = "mediatek,mt6370_pmu_rgbled";
			interrupt-names = "isink4_short", "isink3_short", "isink2_short", "isink1_short", "isink4_open", "isink3_open", "isink2_open", "isink1_open";
			mt,led_default_trigger = "cc_mode", "cc_mode", "cc_mode", "none";
			mt,led_name = "mt6370_pmu_led1", "mt6370_pmu_led2", "mt6370_pmu_led3", "mt6370_pmu_led4";
		};
	};

	mt6370_pmu_eint {
		linux,phandle = <0xa2>;
		phandle = <0xa2>;
	};

	mt_charger {
		compatible = "mediatek,mt-charger";
		linux,phandle = <0x9e>;
		phandle = <0x9e>;
	};

	mt_soc_anc_pcm {
		compatible = "mediatek,mt_soc_pcm_anc";
	};

	mt_soc_btcvsd_rx_pcm {
		compatible = "mediatek,mt_soc_btcvsd_rx_pcm";
	};

	mt_soc_btcvsd_tx_pcm {
		compatible = "mediatek,mt_soc_btcvsd_tx_pcm";
	};

	mt_soc_codec_dummy_name {
		compatible = "mediatek,mt_soc_codec_dummy";
	};

	mt_soc_codec_name {
		compatible = "mediatek,mt_soc_codec_63xx";
		use_hp_depop_flow = <0x0>;
		use_ul_260k = <0x0>;
	};

	mt_soc_dai_name {
		compatible = "mediatek,mt_soc_dai_stub";
	};

	mt_soc_deep_buffer_dl_pcm {
		compatible = "mediatek,mt_soc_pcm_deep_buffer_dl";
	};

	mt_soc_dl1_awb_pcm {
		compatible = "mediatek,mt_soc_pcm_dl1_awb";
	};

	mt_soc_dl1_pcm@11220000 {
		clock-names = "aud_afe_clk", "aud_dac_clk", "aud_dac_predis_clk", "aud_adc_clk", "aud_apll22m_clk", "aud_apll1_tuner_clk", "aud_tml_clk", "aud_infra_clk", "mtkaif_26m_clk", "top_mux_audio", "top_mux_audio_int", "top_sys_pll1_d4", "top_mux_aud_1", "top_apll1_ck", "top_mux_aud_eng1", "top_apll1_d8", "apmixed_apll1", "top_clk26m_clk";
		clocks = <0x3a 0x0 0x3a 0x4 0x3a 0x5 0x3a 0x3 0x3a 0x1 0x3a 0x2 0x3a 0x6 0x1f 0x2b 0x1f 0x33 0x19 0x78 0x19 0x79 0x19 0x5 0x19 0x7a 0x19 0x2b 0x19 0x7b 0x19 0x2e 0x3b 0x6 0x1b>;
		compatible = "mediatek,mt_soc_pcm_dl1";
		interrupts = <0x0 0x61 0x8>;
		linux,phandle = <0x8f>;
		phandle = <0x8f>;
		reg = <0x0 0x11220000 0x0 0x1000>;
	};

	mt_soc_dl2_pcm {
		compatible = "mediatek,mt_soc_pcm_dl2";
	};

	mt_soc_dummy_pcm {
		compatible = "mediatek,mt_soc_pcm_dummy";
	};

	mt_soc_fm_i2s_awb_pcm {
		compatible = "mediatek,mt_soc_pcm_fm_i2s_awb";
	};

	mt_soc_fm_i2s_pcm {
		compatible = "mediatek,mt_soc_pcm_fm_i2s";
	};

	mt_soc_fm_mrgtx_pcm {
		compatible = "mediatek,mt_soc_pcm_fmtx";
	};

	mt_soc_hp_impedance_pcm {
		compatible = "mediatek,mt_soc_pcm_hp_impedance";
	};

	mt_soc_i2s0_awb_pcm {
		compatible = "mediatek,mt_soc_pcm_i2s0_awb";
	};

	mt_soc_i2s0_pcm {
		compatible = "mediatek,mt_soc_pcm_dl1_i2s0";
	};

	mt_soc_i2s0dl1_pcm {
		compatible = "mediatek,mt_soc_pcm_dl1_i2s0dl1";
	};

	mt_soc_mrgrx_awb_pcm {
		compatible = "mediatek,mt_soc_pcm_mrgrx_awb";
	};

	mt_soc_mrgrx_pcm {
		compatible = "mediatek,mt_soc_pcm_mrgrx";
	};

	mt_soc_pcm_voice_ultra {
		compatible = "mediatek,mt_soc_pcm_voice_ultra";
	};

	mt_soc_pcm_voice_usb {
		compatible = "mediatek,mt_soc_pcm_voice_usb";
	};

	mt_soc_pcm_voice_usb_echoref {
		compatible = "mediatek,mt_soc_pcm_voice_usb_echoref";
	};

	mt_soc_routing_dai_name {
		compatible = "mediatek,mt_soc_dai_routing";
	};

	mt_soc_routing_pcm {
		compatible = "mediatek,mt_soc_pcm_routing";
	};

	mt_soc_tdmrx_pcm {
		compatible = "mediatek,mt_soc_tdm_capture";
	};

	mt_soc_ul1_pcm {
		compatible = "mediatek,mt_soc_pcm_capture";
	};

	mt_soc_ul2_pcm {
		compatible = "mediatek,mt_soc_pcm_capture2";
	};

	mt_soc_uldlloopback_pcm {
		compatible = "mediatek,mt_soc_pcm_uldlloopback";
	};

	mt_soc_voice_md1 {
		compatible = "mediatek,mt_soc_pcm_voice_md1";
	};

	mt_soc_voice_md1_bt {
		compatible = "mediatek,mt_soc_pcm_voice_md1_bt";
	};

	mt_soc_voice_md2 {
		compatible = "mediatek,mt_soc_pcm_voice_md2";
	};

	mt_soc_voice_md2_bt {
		compatible = "mediatek,mt_soc_pcm_voice_md2_bt";
	};

	mt_soc_voip_bt_in {
		compatible = "mediatek,mt_soc_pcm_bt_dai";
	};

	mt_soc_voip_bt_out {
		compatible = "mediatek,mt_soc_pcm_dl1_bt";
	};

	mtkfb@0 {
		compatible = "mediatek,mtkfb";
		linux,phandle = <0x93>;
		phandle = <0x93>;
	};

	nfc {
		compatible = "mediatek,nfc-gpio-v2";
		gpio-irq = <0xa>;
		gpio-irq-std = <0x37 0xa 0x0>;
		gpio-rst = <0xac>;
		gpio-rst-std = <0x37 0xac 0x0>;
		linux,phandle = <0x91>;
		phandle = <0x91>;
	};

	nfi@11018000 {
		compatible = "mediatek,nfi";
		reg = <0x0 0x11018000 0x0 0x1000>;
	};

	nfiecc@11019000 {
		compatible = "mediatek,nfiecc";
		reg = <0x0 0x11019000 0x0 0x1000>;
	};

	odm {
		compatible = "simple-bus";
		linux,phandle = <0x9b>;
		phandle = <0x9b>;
	};

	otg_iddig {
		compatible = "mediatek,usb_iddig_bi_eint";
		linux,phandle = <0x9a>;
		phandle = <0x9a>;
	};

	pericfg@10003000 {
		#clock-cells = <0x1>;
		compatible = "mediatek,pericfg", "syscon";
		linux,phandle = <0x47>;
		phandle = <0x47>;
		reg = <0x0 0x10003000 0x0 0x1000>;
	};

	pinctrl@1000b000 {
		#gpio-cells = <0x2>;
		#interrupt-cells = <0x4>;
		compatible = "mediatek,mt6761-pinctrl";
		gpio-controller;
		interrupt-controller;
		interrupts = <0x0 0x73 0x4>;
		linux,phandle = <0x37>;
		mediatek,pctl-regmap = <0x11 0x12 0x13 0x14 0x15 0x16 0x17 0x18>;
		phandle = <0x37>;
		pins-are-numbered;
		reg = <0x0 0x1000b000 0x0 0x1000>;

		msdc0@default {
			linux,phandle = <0x2d>;
			phandle = <0x2d>;

			pins_clk {
				drive-strength = [03];
			};

			pins_cmd {
				drive-strength = [03];
			};

			pins_dat {
				drive-strength = [03];
			};

			pins_ds {
				drive-strength = [03];
			};

			pins_rst {
				drive-strength = [03];
			};
		};

		msdc0@hs200 {
			linux,phandle = <0x2f>;
			phandle = <0x2f>;

			pins_clk {
				drive-strength = [04];
			};

			pins_cmd {
				drive-strength = [03];
			};

			pins_dat {
				drive-strength = [04];
			};

			pins_ds {
				drive-strength = [04];
			};

			pins_rst {
				drive-strength = [03];
			};
		};

		msdc0@hs400 {
			linux,phandle = <0x2e>;
			phandle = <0x2e>;

			pins_clk {
				drive-strength = [04];
			};

			pins_cmd {
				drive-strength = [03];
			};

			pins_dat {
				drive-strength = [04];
			};

			pins_ds {
				drive-strength = [04];
			};

			pins_rst {
				drive-strength = [03];
			};
		};

		msdc0@register_default {
			cmd_edge = [00];
			linux,phandle = <0x30>;
			phandle = <0x30>;
			rdata_edge = [00];
			wdata_edge = [00];
		};

		msdc1@ddr50 {
			linux,phandle = <0x35>;
			phandle = <0x35>;

			pins_clk {
				drive-strength = [03];
			};

			pins_cmd {
				drive-strength = [03];
			};

			pins_dat {
				drive-strength = [03];
			};
		};

		msdc1@default {
			linux,phandle = <0x32>;
			phandle = <0x32>;

			pins_clk {
				drive-strength = [03];
			};

			pins_cmd {
				drive-strength = [03];
			};

			pins_dat {
				drive-strength = [03];
			};
		};

		msdc1@register_default {
			cmd_edge = [00];
			linux,phandle = <0x36>;
			phandle = <0x36>;
			rdata_edge = [00];
			wdata_edge = [00];
		};

		msdc1@sdr104 {
			linux,phandle = <0x33>;
			phandle = <0x33>;

			pins_clk {
				drive-strength = [03];
			};

			pins_cmd {
				drive-strength = [03];
			};

			pins_dat {
				drive-strength = [03];
			};
		};

		msdc1@sdr50 {
			linux,phandle = <0x34>;
			phandle = <0x34>;

			pins_clk {
				drive-strength = [03];
			};

			pins_cmd {
				drive-strength = [03];
			};

			pins_dat {
				drive-strength = [03];
			};
		};

		msdc3@default {
			linux,phandle = <0x4e>;
			phandle = <0x4e>;

			pins_clk {
				drive-strength = [04];
			};

			pins_cmd {
				drive-strength = [04];
			};

			pins_dat {
				drive-strength = [04];
			};
		};

		msdc3@register_default {
			cmd_edge = [01];
			linux,phandle = <0x4f>;
			phandle = <0x4f>;
			rdata_edge = [01];
			wdata_edge = [01];
		};
	};

	pmic_clock_buffer_ctrl {
		compatible = "mediatek,pmic_clock_buffer";
		linux,phandle = <0xa3>;
		mediatek,clkbuf-config = <0x2 0x1 0x1 0x2 0x0 0x0 0x0>;
		mediatek,clkbuf-driving-current = <0x1 0x1 0x1 0x1 0x1 0x1 0x1>;
		mediatek,clkbuf-quantity = <0x7>;
		phandle = <0xa3>;
	};

	pmu {
		compatible = "arm,cortex-a7-pmu";
		interrupt-parent = <0xd>;
		interrupts = <0x1 0x7 0x8>;
	};

	psci {
		compatible = "arm,psci-1.0";
		method = "smc";
	};

	pseudo_m4u {
		compatible = "mediatek,mt-pseudo_m4u";
		iommus = <0x44 0x2>;
	};

	pseudo_m4u-larb0 {
		compatible = "mediatek,mt-pseudo_m4u-port";
		iommus = <0x44 0x0 0x44 0x1 0x44 0x2 0x44 0x3 0x44 0x4 0x44 0x5 0x44 0x6 0x44 0x7>;
		mediatek,larbid = <0x0>;
	};

	pseudo_m4u-larb1 {
		compatible = "mediatek,mt-pseudo_m4u-port";
		iommus = <0x44 0x20 0x44 0x21>;
		mediatek,larbid = <0x1>;
	};

	pseudo_m4u-larb2 {
		compatible = "mediatek,mt-pseudo_m4u-port";
		iommus = <0x44 0x40 0x44 0x41>;
		mediatek,larbid = <0x2>;
	};

	pwm@11006000 {
		clock-names = "PWM1-main", "PWM2-main", "PWM3-main", "PWM4-main", "PWM5-main", "PWM6-main", "PWM-HCLK-main", "PWM-main";
		clocks = <0x1f 0x10 0x1f 0x11 0x1f 0x12 0x1f 0x13 0x1f 0x14 0x1f 0x30 0x1f 0xf 0x1f 0x15>;
		compatible = "mediatek,pwm";
		interrupts = <0x0 0x15 0x8>;
		linux,phandle = <0x78>;
		phandle = <0x78>;
		reg = <0x0 0x11006000 0x0 0x1000>;
	};

	pwrap@1000d000 {
		compatible = "mediatek,pwrap";
		interrupts = <0x0 0x7b 0x4>;
		reg = <0x0 0x1000d000 0x0 0x1000>;
	};

	radio_md_cfg {
		compatible = "mediatek,radio_md_cfg";
		linux,phandle = <0x9c>;
		phandle = <0x9c>;
	};

	reserved-memory {
		#address-cells = <0x2>;
		#size-cells = <0x2>;
		ranges;

		consys-reserve-memory {
			alignment = <0x0 0x1000000>;
			alloc-ranges = <0x0 0x40000000 0x0 0x80000000>;
			compatible = "mediatek,consys-reserve-memory";
			no-map;
			size = <0x0 0x400000>;
		};

		minirdump-reserved-memory@47d70000 {
			compatible = "mediatek,minirdump";
			reg = <0x0 0x47d70000 0x0 0x10000>;
		};

		pstore-reserved-memory@47c90000 {
			compatible = "mediatek,pstore";
			reg = <0x0 0x47c90000 0x0 0xe0000>;
		};

		ram_console-reserved-memory@47c80000 {
			compatible = "mediatek,ram_console";
			reg = <0x0 0x47c80000 0x0 0x10000>;
		};

		reserve-memory-scp_share {
			alignment = <0x0 0x1000000>;
			alloc-ranges = <0x0 0x40000000 0x0 0x50000000>;
			compatible = "mediatek,reserve-memory-scp_share";
			no-map;
			size = <0x0 0x300000>;
		};

		reserve-memory-sspm_share {
			alignment = <0x0 0x10000>;
			alloc-ranges = <0x0 0x40000000 0x0 0x60000000>;
			compatible = "mediatek,reserve-memory-sspm_share";
			no-map;
			size = <0x0 0x510000>;
			status = "okay";
		};

		soter-shared-mem {
			alloc-ranges = <0x0 0x40000000 0x0 0x50000000>;
			compatible = "microtrust,shared_mem";
			no-map;
			size = <0x0 0x200000>;
		};

		wifi-reserve-memory {
			alignment = <0x0 0x1000000>;
			alloc-ranges = <0x0 0x40000000 0x0 0x80000000>;
			compatible = "mediatek,wifi-reserve-memory";
			no-map;
			size = <0x0 0x300000>;
		};
	};

	rt-pd-manager {
		compatible = "mediatek,rt-pd-manager";
	};

	rt9465_slave_chr {
		compatible = "richtek,rt9465";
		linux,phandle = <0xa1>;
		phandle = <0xa1>;
		status = "disabled";
	};

	scp@10500000 {
		compatible = "mediatek,scp";
		core_1 = "enable";
		interrupts = <0x0 0x88 0x4>;
		reg = <0x0 0x10500000 0x0 0x40000 0x0 0x105c0000 0x0 0x3000 0x0 0x105c4000 0x0 0x1000 0x0 0x105d4000 0x0 0x6000>;
		scp_sramSize = <0x40000>;
		status = "okay";
	};

	scp_dvfs {
		clock-names = "clk_mux", "clk_pll_0", "clk_pll_1", "clk_pll_2", "clk_pll_3", "clk_pll_4", "clk_pll_5", "clk_pll_6";
		clocks = <0x19 0x6c 0x1b 0x19 0x10 0x19 0x1d 0x19 0x4 0x19 0x1a 0x19 0x8 0x19 0x1c>;
		compatible = "mediatek,scp_dvfs";
	};

	scpsys@10001000 {
		#clock-cells = <0x1>;
		compatible = "mediatek,scpsys", "syscon";
		linux,phandle = <0x20>;
		phandle = <0x20>;
		reg = <0x0 0x10001000 0x0 0x1000 0x0 0x10006000 0x0 0x1000 0x0 0x14002000 0x0 0x1000 0x0 0x1020e000 0x0 0x1000 0x0 0x18004000 0x0 0x1000>;
	};

	security_ao@1001a000 {
		compatible = "mediatek,security_ao";
		reg = <0x0 0x1001a000 0x0 0x1000>;
	};

	serial@11020000 {
		clock-names = "baud", "bus";
		clocks = <0x1b 0x1f 0x16>;
		compatible = "mediatek,mt6761-uart", "mediatek,mt6577-uart";
		dma-names = "tx", "rx";
		dmas = <0x2c 0x0 0x2c 0x1>;
		interrupts = <0x0 0x23 0x8>;
		linux,phandle = <0x76>;
		phandle = <0x76>;
		reg = <0x0 0x11002000 0x0 0x1000>;
	};

	serial@11030000 {
		clock-names = "baud", "bus";
		clocks = <0x1b 0x1f 0x17>;
		compatible = "mediatek,mt6761-uart", "mediatek,mt6577-uart";
		interrupts = <0x0 0x24 0x8>;
		linux,phandle = <0x77>;
		phandle = <0x77>;
		reg = <0x0 0x11003000 0x0 0x1000>;
	};

	sleep@10006000 {
		compatible = "mediatek,sleep";
		interrupts = <0x0 0x7d 0x8>;
		reg = <0x0 0x10006000 0x0 0x1000>;
		wakeup-source = <0xe 0x0 0x4 0xf 0x1 0x20 0x10 0x3 0x2000000>;
	};

	sleep_reg_md@1000f000 {
		compatible = "mediatek,sleep_reg_md";
		reg = <0x0 0x1000f000 0x0 0x1000>;
	};

	smart_pa {
		linux,phandle = <0x48>;
		phandle = <0x48>;
	};

	smi_common@14002000 {
		clock-names = "mtcmos-dis", "smi-comm0", "smi-comm1", "smi-common";
		clocks = <0x20 0x3 0x21 0x15 0x21 0x16 0x21 0x13>;
		compatible = "mediatek,smi_common";
		larbs = <0x1c 0x1d 0x1e>;
		mmsys_config = <0x21>;
		nr_larbs = <0x3>;
		reg = <0x0 0x14002000 0x0 0x1000>;
	};

	smi_larb0@14003000 {
		cell-index = <0x0>;
		clock-names = "mtcmos-dis", "smi-larb0";
		clocks = <0x20 0x3 0x21 0x14>;
		compatible = "mediatek,smi_larb0", "mediatek,smi_larb";
		linux,phandle = <0x1c>;
		phandle = <0x1c>;
		reg = <0x0 0x14003000 0x0 0x1000>;
	};

	smi_larb1@17010000 {
		cell-index = <0x1>;
		clock-names = "mtcmos-vcodec", "venc-larb1";
		clocks = <0x20 0x9 0x43 0x1>;
		compatible = "mediatek,smi_larb1", "mediatek,smi_larb";
		linux,phandle = <0x1d>;
		phandle = <0x1d>;
		reg = <0x0 0x17010000 0x0 0x10000>;
	};

	smi_larb2@15001000 {
		cell-index = <0x2>;
		clock-names = "mtcmos-cam", "gals-cam2img", "cam-larb2";
		clocks = <0x20 0x8 0x21 0x18 0x3c 0x0>;
		compatible = "mediatek,smi_larb2", "mediatek,smi_larb";
		linux,phandle = <0x1e>;
		phandle = <0x1e>;
		reg = <0x0 0x15001000 0x0 0x1000>;
	};

	spi0@1100a000 {
		clock-names = "parent-clk", "sel-clk", "spi-clk";
		clocks = <0x19 0xd 0x19 0x74 0x1f 0x1b>;
		compatible = "mediatek,mt6765-spi";
		interrupts = <0x0 0x3e 0x8>;
		linux,phandle = <0x84>;
		mediatek,pad-select = <0x0>;
		phandle = <0x84>;
		reg = <0x0 0x1100a000 0x0 0x1000>;
	};

	spi1@11010000 {
		clock-names = "parent-clk", "sel-clk", "spi-clk";
		clocks = <0x19 0xd 0x19 0x74 0x1f 0x34>;
		compatible = "mediatek,mt6765-spi";
		interrupts = <0x0 0x42 0x8>;
		linux,phandle = <0x85>;
		mediatek,pad-select = <0x0>;
		phandle = <0x85>;
		reg = <0x0 0x11010000 0x0 0x1000>;
	};

	spi2@11012000 {
		clock-names = "parent-clk", "sel-clk", "spi-clk";
		clocks = <0x19 0xd 0x19 0x74 0x1f 0x37>;
		compatible = "mediatek,mt6765-spi";
		interrupts = <0x0 0x48 0x8>;
		linux,phandle = <0x86>;
		mediatek,pad-select = <0x0>;
		phandle = <0x86>;
		reg = <0x0 0x11012000 0x0 0x1000>;
	};

	spi3@11013000 {
		clock-names = "parent-clk", "sel-clk", "spi-clk";
		clocks = <0x19 0xd 0x19 0x74 0x1f 0x38>;
		compatible = "mediatek,mt6765-spi";
		interrupts = <0x0 0x49 0x8>;
		linux,phandle = <0x87>;
		mediatek,pad-select = <0x0>;
		phandle = <0x87>;
		reg = <0x0 0x11013000 0x0 0x1000>;
	};

	spi4@11014000 {
		clock-names = "parent-clk", "sel-clk", "spi-clk";
		clocks = <0x19 0xd 0x19 0x74 0x1f 0x41>;
		compatible = "mediatek,mt6765-spi";
		interrupts = <0x0 0x27 0x8>;
		linux,phandle = <0x88>;
		mediatek,pad-select = <0x0>;
		phandle = <0x88>;
		reg = <0x0 0x11014000 0x0 0x1000>;
	};

	spi5@11015000 {
		clock-names = "parent-clk", "sel-clk", "spi-clk";
		clocks = <0x19 0xd 0x19 0x74 0x1f 0x42>;
		compatible = "mediatek,mt6765-spi";
		interrupts = <0x0 0x28 0x8>;
		linux,phandle = <0x89>;
		mediatek,pad-select = <0x0>;
		phandle = <0x89>;
		reg = <0x0 0x11015000 0x0 0x1000>;
	};

	sramrom@10214000 {
		compatible = "mediatek,sramrom";
		reg = <0x0 0x10214000 0x0 0x1000>;
	};

	sspm@10440000 {
		compatible = "mediatek,sspm";
		interrupt-names = "ipc", "mbox0", "mbox1", "mbox2", "mbox3", "mbox4";
		interrupts = <0x0 0x92 0x4 0x0 0x95 0x4 0x0 0x96 0x4 0x0 0x97 0x4 0x0 0x98 0x4 0x0 0x99 0x4>;
		reg = <0x0 0x10440000 0x0 0x10000 0x0 0x10450000 0x0 0x100 0x0 0x10451000 0x0 0x8 0x0 0x10460000 0x0 0x100 0x0 0x10461000 0x0 0x8 0x0 0x10470000 0x0 0x100 0x0 0x10471000 0x0 0x8 0x0 0x10480000 0x0 0x100 0x0 0x10481000 0x0 0x8 0x0 0x10490000 0x0 0x100 0x0 0x10491000 0x0 0x8>;
		reg-names = "cfgreg", "mbox0_base", "mbox0_ctrl", "mbox1_base", "mbox1_ctrl", "mbox2_base", "mbox2_ctrl", "mbox3_base", "mbox3_ctrl", "mbox4_base", "mbox4_ctrl";
	};

	sys_cirq@10204000 {
		compatible = "mediatek,sys_cirq";
		interrupts = <0x0 0xe0 0x8>;
		mediatek,cirq_num = <0xd1>;
		mediatek,spi_start_offset = <0x10>;
		reg = <0x0 0x10204000 0x0 0x1000>;
	};

	sys_timer@10017000 {
		compatible = "mediatek,sys_timer";
		interrupts = <0x0 0x8a 0x4>;
		reg = <0x0 0x10017000 0x0 0x1000>;
		reg-names = "sys_timer_base";
	};

	syscfg_pctl_0@10005000 {
		compatible = "mediatek,mt6761-pctl-0-syscfg", "syscon";
		linux,phandle = <0x11>;
		phandle = <0x11>;
		reg = <0x0 0x10005000 0x0 0x1000>;
	};

	syscfg_pctl_1@10002000 {
		compatible = "mediatek,mt6761-pctl-1-syscfg", "syscon";
		linux,phandle = <0x12>;
		phandle = <0x12>;
		reg = <0x0 0x10002000 0x0 0x1000>;
	};

	syscfg_pctl_2@10002200 {
		compatible = "mediatek,mt6761-pctl-2-syscfg", "syscon";
		linux,phandle = <0x13>;
		phandle = <0x13>;
		reg = <0x0 0x10002200 0x0 0x1000>;
	};

	syscfg_pctl_3@10002400 {
		compatible = "mediatek,mt6761-pctl-3-syscfg", "syscon";
		linux,phandle = <0x14>;
		phandle = <0x14>;
		reg = <0x0 0x10002400 0x0 0x1000>;
	};

	syscfg_pctl_4@10002600 {
		compatible = "mediatek,mt6761-pctl-4-syscfg", "syscon";
		linux,phandle = <0x15>;
		phandle = <0x15>;
		reg = <0x0 0x10002600 0x0 0x1000>;
	};

	syscfg_pctl_5@10002800 {
		compatible = "mediatek,mt6761-pctl-5-syscfg", "syscon";
		linux,phandle = <0x16>;
		phandle = <0x16>;
		reg = <0x0 0x10002800 0x0 0x1000>;
	};

	syscfg_pctl_6@10002a00 {
		compatible = "mediatek,mt6761-pctl-6-syscfg", "syscon";
		linux,phandle = <0x17>;
		phandle = <0x17>;
		reg = <0x0 0x10002a00 0x0 0x1000>;
	};

	syscfg_pctl_7@10002c00 {
		compatible = "mediatek,mt6761-pctl-7-syscfg", "syscon";
		linux,phandle = <0x18>;
		phandle = <0x18>;
		reg = <0x0 0x10002c00 0x0 0x1000>;
	};

	tcpc_pd {
		linux,phandle = <0x49>;
		phandle = <0x49>;
	};

	therm_ctrl@1100b000 {
		clock-names = "therm-main";
		clocks = <0x1f 0xa>;
		compatible = "mediatek,therm_ctrl";
		interrupts = <0x0 0x16 0x8>;
		reg = <0x0 0x1100b000 0x0 0x1000>;
	};

	timer {
		clock-frequency = <0xc65d40>;
		compatible = "arm,armv8-timer";
		interrupt-parent = <0xd>;
		interrupts = <0x1 0xd 0x8 0x1 0xe 0x8 0x1 0xb 0x8 0x1 0xa 0x8>;
	};

	timer@10008000 {
		clock-names = "clk13m", "clk32k";
		clocks = <0x19 0x87 0x1a>;
		compatible = "mediatek,apxgpt";
		interrupts = <0x0 0x72 0x8>;
		linux,phandle = <0x50>;
		phandle = <0x50>;
		reg = <0x0 0x10008000 0x0 0x1000>;
	};

	tkcore {
		compatible = "trustkernel,tkcore";
		interrupts = <0x0 0xc4 0x1>;
	};

	topckgen@10000000 {
		#clock-cells = <0x1>;
		compatible = "mediatek,topckgen", "syscon";
		linux,phandle = <0x19>;
		phandle = <0x19>;
		reg = <0x0 0x10000000 0x0 0x1000>;
	};

	topckgen_ao@1001b000 {
		compatible = "mediatek,topckgen_ao";
		reg = <0x0 0x1001b000 0x0 0x1000>;
	};

	topmisc@10011000 {
		compatible = "mediatek,topmisc";
		reg = <0x0 0x10011000 0x0 0x1000>;
	};

	toprgu@10007000 {
		compatible = "mediatek,toprgu";
		interrupts = <0x0 0x53 0x0>;
		reg = <0x0 0x10007000 0x0 0x1000>;
	};

	touch {
		compatible = "mediatek,touch";
		linux,phandle = <0x71>;
		phandle = <0x71>;
	};

	trng@1020f000 {
		compatible = "mediatek,trng";
		interrupts = <0x0 0x69 0x8>;
		reg = <0x0 0x1020f000 0x0 0x1000>;
	};

	trusty {
		#address-cells = <0x2>;
		#size-cells = <0x2>;
		compatible = "android,trusty-smc-v1";
		ranges;

		irq {
			compatible = "android,trusty-irq-v1";
			ppi-interrupt-parent = <0xd>;
		};

		log {
			compatible = "android,trusty-log-v1";
		};

		mtee {
			compatible = "mediatek,trusty-mtee-v1";
		};

		virtio {
			compatible = "android,trusty-virtio-v1";
		};
	};

	type_c_port0 {
		linux,phandle = <0xa5>;
		mt-tcpc,name = "type_c_port0";
		mt-tcpc,role_def = <0x4>;
		mt-tcpc,rp_level = <0x0>;
		mt-tcpc,vconn_supply = <0x1>;
		mt6370pd,intr_gpio = <0x37 0x18 0x0>;
		mt6370pd,intr_gpio_num = <0x18>;
		phandle = <0xa5>;
		tcpc-dual,supported_modes = <0x0>;

		dpm_caps {
			attemp_discover_cable;
			attemp_discover_id;
			attemp_enter_dp_mode;
			dr_check = <0x0>;
			local_dr_data;
			local_dr_power;
			local_no_suspend;
			local_usb_comm;
			local_vconn_supply;
			pr_check = <0x0>;
			pr_check_gp_source;
		};

		pd-data {
			bat,nr = <0x1>;
			pd,charging_policy = <0x21>;
			pd,country_nr = <0x0>;
			pd,id-vdo-data = <0xd10029cf 0x0 0x10000>;
			pd,id-vdo-size = <0x3>;
			pd,mfrs = "RichtekTCPC";
			pd,pid = <0x5081>;
			pd,sink-pdo-data = <0x190c8 0xc0761e3c>;
			pd,sink-pdo-size = <0x2>;
			pd,source-cap-ext = <0x171129cf 0x0 0x102 0x0 0x0 0x2000000>;
			pd,source-pdo-data = <0x19032>;
			pd,source-pdo-size = <0x1>;
			pd,vid = <0x29cf>;

			bat-info0 {
				bat,design_cap = <0xbb8>;
				bat,mfrs = "bat1";
				bat,pid = <0x1711>;
				bat,vid = <0x29cf>;
			};
		};
	};

	usb0@11200000 {
		clock-names = "usb0", "usb0_clk_top_sel", "usb0_clk_univpll3_d4";
		clocks = <0x1f 0x8 0x19 0x7f 0x19 0x23>;
		compatible = "mediatek,mt6761-usb20";
		interrupts = <0x0 0x11 0x8>;
		mode = <0x2>;
		multipoint = <0x1>;
		num_eps = <0x10>;
		reg = <0x0 0x11200000 0x0 0x10000 0x0 0x11cc0000 0x0 0x10000>;
	};

	usb1p_sif@11210000 {
		compatible = "mediatek,usb1p_sif";
		reg = <0x0 0x11210000 0x0 0x10000>;
	};

	usb_sif@11210000 {
		compatible = "mediatek,usb_sif";
		reg = <0x0 0x11210000 0x0 0x1000>;
	};

	utos {
		compatible = "microtrust,utos";
		interrupts = <0x0 0xbc 0x1 0x0 0xbd 0x1>;
	};

	utos_tester {
		compatible = "microtrust,tester-v1";
	};

	vdec@17040000 {
		compatible = "mediatek,vdec";
		interrupts = <0x0 0xb1 0x8>;
		reg = <0x0 0x17040000 0x0 0x10000>;
	};

	venc@17020000 {
		compatible = "mediatek,venc";
		interrupts = <0x0 0xae 0x8>;
		reg = <0x0 0x17020000 0x0 0x10000>;
	};

	venc_gcon@17000000 {
		#clock-cells = <0x1>;
		clock-names = "MT_SCP_SYS_DIS", "MT_SCP_SYS_VCODEC", "MT_CG_MM_SMI_COMM0", "MT_CG_MM_SMI_COMM1", "MT_CG_MM_SMI_COMMON", "MT_CG_VDEC", "MT_CG_VENC";
		clocks = <0x20 0x3 0x20 0x9 0x21 0x15 0x21 0x16 0x21 0x13 0x43 0x3 0x43 0x1>;
		compatible = "mediatek,venc_gcon", "syscon";
		linux,phandle = <0x43>;
		phandle = <0x43>;
		reg = <0x0 0x17000000 0x0 0x10000>;
	};

	venc_jpg@17030000 {
		clock-names = "MT_CG_VENC_JPGENC";
		clocks = <0x43 0x2>;
		compatible = "mediatek,venc_jpg";
		interrupts = <0x0 0xb0 0x8>;
		reg = <0x0 0x17030000 0x0 0x10000>;
	};

	wifi@18000000 {
		compatible = "mediatek,wifi";
		interrupts = <0x0 0xd4 0x8>;
		reg = <0x0 0x18000000 0x0 0x100000>;
	};
};
